//lahaina-pcie.dtsi
&pcie1 {
		//#ifdef VENDOR_EDIT
		status = "disabled";
		//#endif
};



//lahaina-pinctrl.dtsi

&tlmm {
	//#ifdef OPLUS_FEATURE_FINGERPRINT
	oplus_fp_common{
		gpio_id2_default: gpio_id2_default {
			mux {
				pins = "gpio119";
				function = "gpio";
			};
			config {
				pins = "gpio119";
				drive-strength = <2>;
				bias-pull-up;
				input-enable;
			};
		};
	};
	goodix_fp{
		gpio_goodix_irq_default: gpio_goodix_irq_default {
			mux {
				pins = "gpio38";
				function = "gpio";
			};
			config {
				pins = "gpio38";
				drive-strength = <2>;
				bias-disable;
				input-enable;
			};
		};
	};
	//#endif /*OPLUS_FEATURE_FINGERPRINT*/

	//#ifdef OPLUS_FEATURE_TP_BASIC
	/* add pingrp for touchscreen */
	pmx_ts_int_active2 {
		ts_int_active2: ts_int_active2 {
			mux {
				pins = "gpio23";
				function = "gpio";
			};

			config {
				pins = "gpio23";
				drive-strength = <8>;
				bias-disable;
				input-enable;
			};
		};
	};

	pmx_ts_int_suspend2 {
		ts_int_suspend2: ts_int_suspend2 {
			mux {
				pins = "gpio23";
				function = "gpio";
			};

			config {
				pins = "gpio23";
				drive-strength = <8>;
				//bias-pull-down;
				bias-pull-up;
				input-enable;
			};
		};
	};

	pmx_ts_reset_active2 {
		ts_reset_active2: ts_reset_active2 {
			mux {
				pins = "gpio22";
				function = "gpio";
			};

			config {
				pins = "gpio22";
				drive-strength = <8>;
				output-low;
				bias-disable;
			};
		};
	};

	pmx_ts_reset_suspend2 {
		ts_reset_suspend2: ts_reset_suspend2 {
			mux {
				pins = "gpio22";
				function = "gpio";
			};

			config {
				pins = "gpio22";
				drive-strength = <2>;
				bias-pull-down;
			};
		};
	};
	//#endif /*OPLUS_FEATURE_TP_BASIC*/

	//#ifdef OPLUS_FEATURE_TP_BASIC
	/* add pingrp for touchscreen */
	pmx_ts_int_active_oplus {
		ts_int_active: ts_int_active {
			mux {
				pins = "gpio99";
				function = "gpio";
			};

			config {
				pins = "gpio99";
				drive-strength = <8>;
				bias-disable;
				input-enable;
			};
		};
	};

	pmx_ts_int_suspend_oplus {
		ts_int_suspend1: ts_int_suspend1 {
			mux {
				pins = "gpio99";
				function = "gpio";
			};

			config {
				pins = "gpio99";
				drive-strength = <8>;
				//bias-pull-down;
				bias-pull-up;
				input-enable;
			};
		};
	};

	pmx_ts_reset_active_oplus {
		ts_reset_active: ts_reset_active {
			mux {
				pins = "gpio42";
				function = "gpio";
			};

			config {
				pins = "gpio42";
				drive-strength = <8>;
				output-low;
				bias-disable;
			};
		};
	};

	pmx_ts_reset_suspend_oplus {
		ts_reset_suspend1: ts_reset_suspend1 {
			mux {
				pins = "gpio42";
				function = "gpio";
			};

			config {
				pins = "gpio42";
				drive-strength = <2>;
				bias-pull-down;
			};
		};
	};
	//#endif /*OPLUS_FEATURE_TP_BASIC*/

	//#ifdef VENDOR_EDIT
	pmx_press_int_active {
		press_int_active: press_int_active {
			mux {
				pins = "gpio51";
				function = "gpio";
			};

			config {
				pins = "gpio51";
				drive-strength = <2>;
				bias-disable;
				input-enable;
			};
		};
	};

	pmx_press_watchdog_active {
		watchdog_active: watchdog_active {
			mux {
				pins = "gpio97";
				function = "gpio";
			};

			config {
				pins = "gpio97";
				drive-strength = <2>;
				bias-disable;
				output-high;
			};
		};
	};
	//#endif

// #ifdef OPLUS_FEATURE_CHG_BASIC
	aw_haptics: aw_haptics {
		aw_irq_gpio_default: aw_irq_gpio_default {
			mux {
				pins = "gpio79";
				function = "gpio";
			};

			config {
				pins = "gpio79";
				drive-strength = <2>;
				input-enable;
				bias-pull-up; /*PULL UP*/
				//bias-disable;
			};
		};
	};
// #endif /* OPLUS_FEATURE_CHG_BASIC */

	//#ifdef VENDOR_EDIT
	pmx_sde: pmx_sde {
		sde_dsi_active: sde_dsi_active {
			mux {
				pins = "gpio24";
				function = "gpio";
			};

			config {
				pins = "gpio24";
				drive-strength = <8>;   /* 8 mA */
				bias-disable = <0>;   /* no pull */
			};
		};

		sde_dsi_suspend: sde_dsi_suspend {
			mux {
				pins = "gpio24";
				function = "gpio";
			};

			config {
				pins = "gpio24";
				drive-strength = <2>;   /* 2 mA */
				bias-pull-down;         /* PULL DOWN */
			};
		};

		sde_dsi1_active: sde_dsi1_active {
			mux {
				pins = "gpio25";
				function = "gpio";
			};

			config {
				pins = "gpio25";
				drive-strength = <8>;   /* 8 mA */
				bias-disable = <0>;   /* no pull */
			};
		};

		sde_dsi1_suspend: sde_dsi1_suspend {
			mux {
				pins = "gpio25";
				function = "gpio";
			};

			config {
				pins = "gpio25";
				drive-strength = <2>;   /* 2 mA */
				bias-pull-down;         /* PULL DOWN */
			};
		};
	};

	pmx_sde_te: pmx_sde_te {
		sde_te_active: sde_te_active {
			mux {
				pins = "gpio82";
				function = "mdp_vsync";
			};

			config {
				pins = "gpio82";
				drive-strength = <2>;   /* 2 mA */
				bias-pull-down;         /* PULL DOWN */
			};
		};

		sde_te_suspend: sde_te_suspend {
			mux {
				pins = "gpio82";
				function = "mdp_vsync";
			};

			config {
				pins = "gpio82";
				drive-strength = <2>;   /* 2 mA */
				bias-pull-down;         /* PULL DOWN */
			};
		};

		sde_te1_active: sde_te1_active {
			mux {
				pins = "gpio83";
				function = "mdp_vsync";
			};

			config {
				pins = "gpio83";
				drive-strength = <2>;   /* 2 mA */
				bias-pull-down;         /* PULL DOWN */
			};
		};

		sde_te1_suspend: sde_te1_suspend {
			mux {
				pins = "gpio83";
				function = "mdp_vsync";
			};

			config {
				pins = "gpio83";
				drive-strength = <2>;   /* 2 mA */
				bias-pull-down;         /* PULL DOWN */
			};
		};
	};
	//#endif
	cam_sensor_mclk0_active {

		config {
			/* #ifdef OPLUS_FEATURE_CAMERA_COMMON */
			drive-strength = <6>; /* 6 MA */
			/* #else */
			// drive-strength = <2>; /* 2 MA */
			/* #endif */
		};
	};
	cam_sensor_mclk0_suspend {

		config {
			/* #ifdef OPLUS_FEATURE_CAMERA_COMMON */
			drive-strength = <6>; /* 6 MA */
			/* #else */
			// drive-strength = <2>; /* 2 MA */
			/* #endif */
		};
	};
	cam_sensor_mclk1_suspend {

		config {
			/* #ifdef OPLUS_FEATURE_CAMERA_COMMON */
			drive-strength = <6>; /* 6 MA */
			/* #else */
			// drive-strength = <2>; /* 2 MA */
			/* #endif */
		};
	};

	cam_sensor_mclk2_active {

		config {
			/* #ifdef OPLUS_FEATURE_CAMERA_COMMON */
			drive-strength = <6>; /* 6 MA */
			/* #else */
			// drive-strength = <2>; /* 2 MA */
			/* #endif */
		};
	};

	cam_sensor_mclk2_suspend {

		config {
			/* #ifdef OPLUS_FEATURE_CAMERA_COMMON */
			drive-strength = <6>; /* 6 MA */
			/* #else */
			// drive-strength = <2>; /* 2 MA */
			/* #endif */
		};
	};

	cam_sensor_mclk3_active {

		config {
			/* #ifdef OPLUS_FEATURE_CAMERA_COMMON */
			drive-strength = <6>; /* 6 MA */
			/* #else */
			// drive-strength = <2>; /* 2 MA */
			/* #endif */
		};
	};

	cam_sensor_mclk3_suspend {

		config {
			/* #ifdef OPLUS_FEATURE_CAMERA_COMMON */
			drive-strength = <6>; /* 6 MA */
			/* #else */
			// drive-strength = <2>; /* 2 MA */
			/* #endif */
		};
	};

	cam_sensor_mclk4_active {

		config {
			/* #ifdef OPLUS_FEATURE_CAMERA_COMMON */
			drive-strength = <6>; /* 6 MA */
			/* #else */
			// drive-strength = <2>; /* 2 MA */
			/* #endif */
		};
	};

	cam_sensor_mclk4_suspend {

		config {
			/* #ifdef OPLUS_FEATURE_CAMERA_COMMON */
			drive-strength = <6>; /* 6 MA */
			/* #else */
			// drive-strength = <2>; /* 2 MA */
			/* #endif */
		};
	};

	cam_sensor_mclk5_active {

		config {
			/* #ifdef OPLUS_FEATURE_CAMERA_COMMON */
			drive-strength = <6>; /* 6 MA */
			/* #else */
			// drive-strength = <2>; /* 2 MA */
			/* #endif */
		};
	};

	cam_sensor_mclk5_suspend {

		config {
			/* #ifdef OPLUS_FEATURE_CAMERA_COMMON */
			drive-strength = <6>; /* 6 MA */
			/* #else */
			// drive-strength = <2>; /* 2 MA */
			/* #endif */
		};
	};

	//#ifdef OPLUS_FEATURE_RF_CABLE_DETECT
	rf_cable0_active: rf_cable0_active {
		mux {
			pins = "gpio91";
			function = "gpio";
		};
		config {
			pins = "gpio91";
			drive-strength = <2>;
			input-enable;
			bias-pull-up;
		};
	};
	//#endif /* OPLUS_FEATURE_RF_CABLE_DETECT */
};



//lahaina-pmic-overlay.dtsi
&pm8350_gpios {
//#ifndef VENDOR_EDIT
	///delete-node/ key_vol_up;
//#else
	key_vol_down {
		key_vol_down_default: key_vol_down_default {
			pins = "gpio6";
			function = "normal";
			input-enable;
			bias-pull-up;
			power-source = <1>;
		};
	};
//#endif
};

&qupv3_se13_i2c {
	pm8008j@c {
		status = "disabled";
	};

	pm8008j@d {
		status = "disabled";
	};
};



&pm8350_gpios {

//#ifdef VENDOR_EDIT
	pm8350_gpio2 {
		pm8350_gpio2_default: pm8350_gpio2_default {
			pins = "gpio2";
			bias-high-impedance;
		};
	};
//#endif /*VENDOR_EDIT*/
};

&pmk8350_gpios {
	pmk8350_pa5 {
		pmk8350_pa5_therm_default: pmk8350_pa5_therm_default {
			pins = "gpio3";
			bias-high-impedance;
		};
	};

};

&pm8350b_gpios {
	pm8350b_pa6 {
		pm8350b_pa6_therm_default: pm8350b_pa6_therm_default {
			pins = "gpio1";
			bias-high-impedance;
		};
	};

};

&spmi_bus {
	qcom,pmk8350@0 {
		pm8350_adc_tm_iio: adc_tm_iio@3400 {
			/* Alternate ADC_TM DT node */
			compatible = "qcom,adc-tm7-iio";
			/* With this entry, a feature-reduced
			version of the driver is initialized (only
			thermistor reads, no interrupt functionality
			for exposed thermistors) */
			reg = <0x3400>;
			#thermal-sensor-cells = <1>;
			#address-cells = <1>;
			#size-cells = <0>;
			io-channels = <&pmk8350_vadc PM8350B_ADC7_GPIO1_100K_PU>,
				      <&pmk8350_vadc PMK8350_ADC7_AMUX_THM4_100K_PU>;
			/* Similar to io-channels in actual ADC_TM node,
			for reading thermistor temperature from
			VADC */

			pm8350b_pa_therm6 {
				/* ADC_TM child node, similar to previous */
				reg = <PM8350B_ADC7_GPIO1_100K_PU>;
				qcom,ratiometric;
				qcom,hw-settle-time = <200>;
			};
			pmk8350_pa_therm5 {
				/* ADC_TM child node, similar to previous */
				reg = <PMK8350_ADC7_AMUX_THM4_100K_PU>;
				qcom,ratiometric;
				qcom,hw-settle-time = <200>;
			};

		};
	};
};

&pmk8350_vadc {
	pinctrl-names = "default";
//#ifndef VENDOR_EDIT
	//pinctrl-0 = <&pm8350_rear_tof_therm_default>;
//#else
	pinctrl-0 = <&pm8350_gpio2_default &pmk8350_pa5_therm_default &pm8350b_pa6_therm_default>;

	pm8350_board_id {
		reg = <PM8350_ADC7_GPIO1>;
		label = "pm8350_board_id";
		//qcom,ratiometric;
		qcom,hw-settle-time = <200>;
		qcom,pre-scaling = <1 1>;
	};
//#endif /*VENDOR_EDIT*/

	pmk8350_pa_therm5 {
		reg = <PMK8350_ADC7_AMUX_THM4_100K_PU>;
		label = "pmk8350_pa_therm5";
		qcom,ratiometric;
		qcom,hw-settle-time = <200>;
		qcom,pre-scaling = <1 1>;
	};

	pm8350b_pa_therm6 {
		reg = <PM8350B_ADC7_GPIO1_100K_PU>;
		label = "pm8350b_pa_therm6";
		qcom,ratiometric;
		qcom,hw-settle-time = <200>;
		qcom,pre-scaling = <1 1>;
	};
};

//#ifdef OPLUS_FEATURE_CHG_BASIC
&pm8350_tz {
	qcom,need_check_ref_byp;
};

&pm8350b_tz {
	qcom,need_check_ref_byp;
};

&pm8350c_tz {
	qcom,need_check_ref_byp;
};

&pmr735a_tz {
	qcom,need_check_ref_byp;
};
//#endif

&thermal_zones {
	pa-therm5-usr {
		polling-delay-passive = <0>;
		polling-delay = <0>;
		thermal-governor = "user_space";
		thermal-sensors = <&pm8350_adc_tm_iio PMK8350_ADC7_AMUX_THM4_100K_PU>;
		/* phandle and channel number of added channel */
		wake-capable-sensor;
		trips {
			active-config0 {
				temperature = <55000>;
				hysteresis = <1000>;
				type = "passive";
			};
		};
	};

	pa-therm6-usr {
		polling-delay-passive = <0>;
		polling-delay = <0>;
		thermal-governor = "user_space";
		thermal-sensors = <&pm8350_adc_tm_iio PM8350B_ADC7_GPIO1_100K_PU>;
		/* phandle and channel number of added channel */
		wake-capable-sensor;
		trips {
			active-config0 {
				temperature = <55000>;
				hysteresis = <1000>;
				type = "passive";
			};
		};
	};
};

//#ifdef OPLUS_FEATURE_CHG_BASIC
/* Baoquan.Lai@BSP.Haptic,add 2021/03/15 for vib aw8697 */
&qupv3_se17_i2c  {
	status = "ok";
	/* AWINIC AW8697 Haptic */
	aw8697_haptic@5A {
		compatible = "awinic,aw8697_haptic";
		reg = <0x5A>;
		reset-gpio = <&tlmm 75 0>;
		irq-gpio = <&tlmm 79 0>;
		status = "ok";
		qcom,device_id = <81538>;//150Hz

		pinctrl-names = "default";
		pinctrl-0 = <&aw_irq_gpio_default>;
	};
	/* AWINIC AW8697 Haptic End */
};
//#endif /* OPLUS_FEATURE_CHG_BASIC */

&battery_charger {
	//for oplus chg framework:
	oplus,chg_ops = "plat-pmic";
	qcom,smart_charging_screenoff;
	qcom,input_current_charger_ma = <2000>;
	qcom,pd_input_current_charger_ma = <1600>;
	qcom,qc_input_current_charger_ma = <1600>;

	qcom,input_current_usb_ma = <500>;

	qcom,input_current_cdp_ma = <1500>;
	qcom,input_current_led_ma = <1200>;
	qcom,input_current_led_ma_high = <1800>;
	qcom,input_current_led_ma_warm = <1800>;
	qcom,input_current_led_ma_normal = <2000>;
	qcom,led_warm_bat_decidegc = <350>;
	qcom,led_high_bat_decidegc = <370>;

	qcom,input_current_camera_ma = <1200>;

	qcom,input_current_vooc_led_ma_high = <1800>;
	qcom,input_current_vooc_led_ma_warm = <1800>;
	qcom,input_current_vooc_led_ma_normal = <3600>;
	qcom,input_current_vooc_ma_normal = <3600>;
	qcom,vooc_temp_bat_normal_decidegc = <350>;
	qcom,input_current_vooc_ma_warm = <3200>;
	qcom,vooc_temp_bat_warm_decidegc = <370>;
	qcom,input_current_vooc_ma_high = <2200>;
	qcom,vooc_temp_bat_hot_decidegc = <440>;

	qcom,charger_current_vooc_ma_normal = <1800>;

	qcom,chg_ctrl_by_calling;
	qcom,input_current_calling_ma = <1500>;

	//qcom,input_current_led_ma_overtemp = <900>;
	qcom,overtemp_bat_decidegc = <350>;
	qcom,iterm_disabled = <0>;
	qcom,iterm_ma = <120>;
	qcom,sub_iterm_ma = <104>;
	qcom,recharge-mv = <100>;
	qcom,batt_capacity_mah = <4500>;/*typical capacity*/
	//qcom,batt_capacity_mah = <4400>; /*rated capacity*/

	qcom,removed_bat_decidegc = <190>;  /*<-19C*/

	qcom,cold_bat_decidegc = <20>;  /*-2C~0C*/
	qcom,temp_cold_vfloat_mv = <3980>;
	qcom,temp_cold_fastchg_current_ma = <300>;

	qcom,little_cold_bat_decidegc = <0>;	/*0C~5C*/
	qcom,temp_little_cold_vfloat_mv = <4465>;
	qcom,temp_little_cold_fastchg_current_ma_high = <2200>;
	qcom,temp_little_cold_fastchg_current_ma_low = <2073>;
	qcom,temp_little_cold_fastchg_current_ma = <2073>;
	qcom,pd_temp_little_cold_fastchg_current_ma_high = <2928>;
	qcom,pd_temp_little_cold_fastchg_current_ma_low = <2073>;
	qcom,qc_temp_little_cold_fastchg_current_ma_high = <2928>;
	qcom,qc_temp_little_cold_fastchg_current_ma_low = <2073>;

	qcom,cool_bat_decidegc = <50>;	/*5C~12C*/
	qcom,temp_cool_vfloat_mv = <4465>;
	qcom,temp_cool_fastchg_current_ma_high = <2200>;
	qcom,temp_cool_fastchg_current_ma_low = <2073>;
	qcom,pd_temp_cool_fastchg_current_ma_high = <3300>;
	qcom,pd_temp_cool_fastchg_current_ma_low = <2928>;
	qcom,qc_temp_cool_fastchg_current_ma_high = <3300>;
	qcom,qc_temp_cool_fastchg_current_ma_low = <2928>;

	qcom,little_cool_bat_decidegc = <120>;	/*12C~16C*/
	qcom,temp_little_cool_vfloat_mv = <4465>;
	qcom,temp_little_cool_fastchg_current_ma = <2200>;
	qcom,pd_temp_little_cool_fastchg_current_ma = <3300>;
	qcom,qc_temp_little_cool_fastchg_current_ma = <3300>;

	qcom,normal_bat_decidegc = <160>;	/*16C~44C*/
	qcom,temp_normal_fastchg_current_ma = <2200>;
	qcom,temp_normal_vfloat_mv = <4465>;
	qcom,pd_temp_normal_fastchg_current_ma = <3300>;
	qcom,qc_temp_normal_fastchg_current_ma = <3300>;

	qcom,warm_bat_decidegc = <450>;		/*45C~53C*/ /*8pin Bat Vooc project need add 3 degree C*/
	qcom,temp_warm_vfloat_mv = <4130>;
	qcom,temp_warm_fastchg_current_ma = <1250>;
	qcom,pd_temp_warm_fastchg_current_ma = <1250>;
	qcom,qc_temp_warm_fastchg_current_ma = <1250>;
	qcom,temp_warm_fastchg_current_ma_led_on = <500>;

	qcom,hot_bat_decidegc = <530>;

	qcom,non_standard_vfloat_mv = <3980>;
	qcom,non_standard_fastchg_current_ma = <512>;

	qcom,short_c_bat_cv_mv = <4330>;
	qcom,short_c_bat_vfloat_mv = <3800>;
	qcom,short_c_bat_fastchg_current_ma = <512>;

	qcom,cold_vfloat_sw_limit = <3930>;
	qcom,little_cold_vfloat_sw_limit = <4415>;
	qcom,cool_vfloat_sw_limit = <4415>;
	qcom,little_cool_vfloat_sw_limit = <4415>;
	qcom,normal_vfloat_sw_limit = <4415>;
	qcom,warm_vfloat_sw_limit = <4080>;
	qcom,non_standard_vfloat_sw_limit = <3930>;
	qcom,short_c_bat_vfloat_sw_limit = <3750>;

	qcom,max_chg_time_sec = <36000>;
	qcom,charger_hv_thr = <9900>;
	qcom,charger_recv_thr = <9500>;
	qcom,charger_lv_thr = <3400>;
	qcom,vbatt_full_thr = <4465>;
	qcom,vbatt_hv_thr = <4600>;
	qcom,vfloat_step_mv = <8>;
	qcom,non_standard_vfloat_over_sw_limit = <3990>;
	qcom,cold_vfloat_over_sw_limit = <3990>;
	qcom,little_cold_vfloat_over_sw_limit = <4505>;
	qcom,cool_vfloat_over_sw_limit = <4505>;
	qcom,little_cool_vfloat_over_sw_limit = <4505>;
	qcom,normal_vfloat_over_sw_limit = <4505>;
	qcom,warm_vfloat_over_sw_limit = <4140>;

	qcom,vbatt_power_off = <3300>;
	qcom,vbatt_soc_1 = <3400>;
	qcom,vooc_project = <5>;
	qcom,vbatt_num = <1>;
	qcom,ffc_support;
	qcom,dual_ffc;
	recharge_after_full;
	qcom,wireless_support;
	qcom,wpc_no_chargerpump;
	qcom,usbtemp_batttemp_gap = <12>;
	qcom,fg_info_package_read_support;

	qcom,normal_vterm_hw_inc = <18>;
	qcom,non_normal_vterm_hw_inc = <18>;

	qcom,ff1_normal_fastchg_ma = <1800>;/*12C~35c*/
	qcom,ff1_warm_fastchg_ma = <1800>;/*35C~40c*/
	qcom,ffc2_normal_fastchg_ma = <1500>;/*12C~35c*/
	qcom,ffc2_temp_warm_decidegc = <350>;
	qcom,ffc2_warm_fastchg_ma = <1600>;/*35C~40c*/
	qcom,ffc2_temp_high_decidegc = <400>;
	qcom,ffc2_temp_low_decidegc = <120>;
	qcom,ffc2_exit_step_ma = <850>;
	qcom,ffc2_warm_exit_step_ma = <850>;
	qcom,ff1_exit_step_ma = <1150>;
	qcom,ff1_warm_exit_step_ma = <1050>;
	qcom,sub_ffc2_exit_step_ma = <1000>;
	qcom,sub_ffc2_warm_exit_step_ma = <1000>;
	qcom,sub_ff1_exit_step_ma = <1300>;
	qcom,sub_ff1_warm_exit_step_ma = <1200>;

	qcom,ffc_normal_vfloat_sw_limit = <4505>;
	qcom,ffc2_normal_vfloat_sw_limit = <4505>;
	qcom,ffc2_warm_vfloat_sw_limit = <4505>;
	qcom,ffc_temp_normal_vfloat_mv = <4580>;
	qcom,ffc1_temp_normal_vfloat_mv = <4580>;
	qcom,ffc2_temp_normal_vfloat_mv = <4580>;
	qcom,ffc_normal_vfloat_over_sw_limit = <4580>;
	qcom,ffc1_normal_vfloat_over_sw_limit = <4580>;
	qcom,ffc2_normal_vfloat_over_sw_limit = <4580>;

	qcom,default_iterm_ma = <120>;
	qcom,default_sub_iterm_ma = <104>;
	qcom,default_temp_normal_fastchg_current_ma = <2000>;
	qcom,default_normal_vfloat_sw_limit = <4415>;
	qcom,default_temp_normal_vfloat_mv = <4465>;
	qcom,default_normal_vfloat_over_sw_limit = <4505>;

	qcom,default_temp_little_cool_fastchg_current_ma = <2200>;
	qcom,default_little_cool_vfloat_sw_limit = <4415>;
	qcom,default_temp_little_cool_vfloat_mv = <4465>;
	qcom,default_little_cool_vfloat_over_sw_limit = <4505>;

	///qcom,offset_temp = <30>;
	//for control:
	//qcom,suspend_after_full;
	qcom,check_batt_full_by_sw;
	qcom,external_gauge;
	qcom,chg_ctrl_by_lcd;
	qcom,chg_ctrl_by_camera;
	qcom,sw_vfloat_over_protect_enable;
	qcom,voocphy_support = <2>;
	qcom,chargerid_switch-gpio = <&tlmm 3 0x00>;
	//for PD9V or QC9V
	qcom,vbatt_pdqc_to_5v_thr = <4465>;
	qcom,vbatt_pdqc_to_9v_thr = <4465>;
	qcom,otg_scheme = <0>; //0:cid 1:ccdetect_gpio 2:switch

	qcom,vooc_show_ui_soc_decimal;
	qcom,ui_soc_decimal_speedmin = <20>;//2A

	qcom,dischg-gpio = <&pm8350c_gpios 9 0x00>;
	pinctrl-names = "usbtemp_l_gpio_default", "usbtemp_r_gpio_default",
			"dischg_enable", "dischg_disable",
			"chg_qupv3_se3_2uart_active", "chg_qupv3_se3_2uart_sleep",
			"chargerid_switch_active", "chargerid_switch_sleep", "chargerid_switch_default",
			"batt_btb_temp_default";

	pinctrl-0 = <&usbtemp_l_gpio_default>;
	pinctrl-1 = <&usbtemp_r_gpio_default>;
	pinctrl-2 = <&dischg_enable>;
	pinctrl-3 = <&dischg_disable>;
	pinctrl-4 = <&chg_qupv3_se3_2uart_active>;
	pinctrl-5 = <&chg_qupv3_se3_2uart_sleep>;
	pinctrl-6 = <&chargerid_switch_active>;
	pinctrl-7 = <&chargerid_switch_sleep>;
	pinctrl-8 = <&chargerid_switch_default>;
	pinctrl-9 = <&batt_btb_temp_default>;
};

#include "opluschg_wireless_fw.dtsi"

&pm8350_gpios {
	/delete-node/ pm8350_rear_tof_therm_default;
	usbtemp_l_gpio_default: usbtemp_l_gpio_default {
		pins = "gpio1"; /* GPIO 1 */
		function = "normal"; /* normal */
		bias-high-impedance; /* DISABLE GPIO1 for ADC*/
    };
	usbtemp_r_gpio_default: usbtemp_r_gpio_default {
        pins = "gpio3"; /* GPIO 3 */
		function = "normal"; /* normal */
        bias-high-impedance; /* DISABLE GPIO3 for ADC*/
    };
};

&pm8350b_gpios {
	batt_btb_temp_default: batt_btb_temp_default {
		pins = "gpio3"; /* GPIO 3 */
		function = "normal"; /* normal */
		bias-high-impedance; /* DISABLE PM8350BHS GPIO3 for ADC*/
	};
};

&pmk8350_vadc {
	/delete-node/ pm8350_rear_tof_therm;
	usb_temp_adc {
		reg = <PM8350_ADC7_AMUX_THM5_100K_PU>;
		label = "usb_temp_adc";
		qcom,pre-scaling = <1 1>;
		qcom,ratiometric;
		qcom,hw-settle-time = <200>;
	};
	usb_supplementary_temp_adc {
		reg = <PM8350_ADC7_GPIO2_100K_PU>;
		label = "usb_supplementary_temp_adc";
		qcom,pre-scaling = <1 1>;
		qcom,ratiometric;
		qcom,hw-settle-time = <200>;
	};
	batt_btb_temp_adc {
		reg = <PM8350B_ADC7_GPIO3_100K_PU>;
		label = "batt_btb_temp_adc";
		qcom,pre-scaling = <1 1>;
		qcom,ratiometric;
		qcom,hw-settle-time = <200>;
	};
};

&battery_charger {
	io-channels	= <&pmk8350_vadc PM8350_ADC7_AMUX_THM5_100K_PU>,
					<&pmk8350_vadc PM8350_ADC7_GPIO2_100K_PU>,
					<&pmk8350_vadc PM8350B_ADC7_GPIO3_100K_PU>;
	io-channel-names = "usb_temp_adc",
						"usb_supplementary_temp_adc",
						"batt_btb_temp_adc";
};

&pm8350c_gpios {
	dischg_enable: dischg_enable {
		pins = "gpio9"; /* GPIO 9 */
		function = "normal"; /* normal */
		bias-disable; //No Pull
		power-source = <0>;//VIN0 3.3
		output-high; //digital output, no invert
		qcom,drive-strength = <3>; //LOW strength
		//drive-push-pull;//CMOS
	};

	dischg_disable: dischg_disable {
		pins = "gpio9"; /* GPIO 9 */
		function = "normal"; /* normal */
		bias-disable; //No Pull
		power-source = <0>;//VIN0 3.3
		output-low; //digital output, no invert
		qcom,drive-strength = <3>; //LOW strength
		//drive-push-pull;//CMOS
	};
};
/*&pm8350c_gpios {
	vooc_vbus_adc_active: vooc_vbus_adc_active {
		pins = "gpio8";
		function = "normal";
		qcom,drive-strength = <2>;
		power-source = <1>;
		bias-pull-up;
		output-high;
	};

	vooc_vbus_adc_sleep: vooc_vbus_adc_sleep {
		pins = "gpio8";
		function = "normal";
		qcom,drive-strength = <2>;
		power-source = <1>;
		bias-pull-down;
		output-low;
	};
};*/

&tlmm {
	chg_qupv3_se3_2uart_active: chg_qupv3_se3_2uart_active {
		mux {
			pins = "gpio18", "gpio19";
			function = "qup3";
		};

		config {
			pins = "gpio18", "gpio19";
			drive-strength = <2>;
			bias-disable;
		};
	};

	chg_qupv3_se3_2uart_sleep: chg_qupv3_se3_2uart_sleep {
		mux {
			pins = "gpio18", "gpio19";
			function = "gpio";
		};

		config {
			pins = "gpio18", "gpio19";
			drive-strength = <2>;
			input-enable;
			bias-pull-down;
		};
	};

	/*ship_sleep: ship_sleep {
		mux {
			pins = "gpio29";
			function = "gpio";
		};

		config {
			pins = "gpio29";
			drive-strength = <2>;
			bias-pull-down;
			output-low;
		};
	};

	ship_active: ship_active {
		mux {
			pins = "gpio29";
			function = "gpio";
		};

		config {
			pins = "gpio29";
			drive-strength = <2>;
			bias-pull-up;
			output-high;
		};
	};*/
};

&smb1398_debug {
	status = "ok";
};

&soc {
	oplus,track-charge {
		compatible = "oplus,track-charge";
		track,fast_chg_break_t_thd = <1000>;
		track,general_chg_break_t_thd = <200>;
		track,voocphy_type = <2>;
		track,wls_max_power = <15000>;
		track,wired_max_power = <33000>;
		track,wls_bpp_chg_scheme = <0>;
		track,wls_epp_chg_scheme = <0>;
		track,wls_fast_chg_scheme = <0>;
		track,wired_fast_chg_scheme = <5>;
	};

	oplus_battery_log: oplus,battery_log {
		compatible = "oplus,battery_log";
		oplus,battery_log_support;
	};
};

&usb2_phy0 {
	qcom,param-override-seq =
		<0xe7 0x6c
		0x0e 0x70
		0x17 0x74
		0x03 0x78>;
};
//#endif /*OPLUS_FEATURE_CHG_BASIC*/



//#lahaina-qupv3.dtsi
//#ifdef OPLUS_FEATRUE_ESIM
/*
&qupv3_se0_spi {
	status = "disabled";
};
*/
//#endif /* OPLUS_FEATRUE_ESIM */

&qupv3_se0_i2c {
// #ifdef OPLUS_FEATURE_CHG_BASIC
		status = "ok";
//else
//		status = "disabled";
// #endif OPLUS_FEATURE_CHG_BASIC
};

//#ifdef OPLUS_FEATRUE_ESIM
/*
&qupv3_se10_spi {
		status = "disabled";
};
*/
//#endif /* OPLUS_FEATRUE_ESIM */


//lahaina-regulators.dtsi
&pm8350c_l6 {
//#ifdef VENDOR_EDIT
	/delete-property/ qcom,proxy-consumer-enable;
	/delete-property/ qcom,proxy-consumer-current;
//#endif /*VENDOR_EDIT*/
};


//pm8350c.dtsi
&pm8350c_switch0 {
	qcom,led-mask = <1>; /* Channels 1 & 4 */
	qcom,symmetry-en;
};

&pm8350c_torch1 {
/*#ifdef OPLUS_FEATURE_CAMERA_COMMON*/
				qcom,max-current-ma = <25>;
				qcom,ires-ua = <5000>;
/*#endif*/
};
&pm8350c_torch2 {
/*#ifdef OPLUS_FEATURE_CAMERA_COMMON*/
				qcom,max-current-ma = <25>;
				qcom,ires-ua = <5000>;
/*#endif*/
};


//pmk8350.dtsi
&pmk8350 {
	pon_pbs@800 {
		//#ifdef OPLUS_FEATURE_QCOM_PMICWD
		qcom,pmicwd;
		//#endif /* OPLUS_FEATURE_QCOM_PMICWD */
	};
  
	pon_hlos@1300 {
				//#ifndef VENDOR_EDIT
			/*qcom,pon_2 {
				qcom,pon-type = <PON_POWER_ON_TYPE_RESIN>;
				linux,code = <KEY_VOLUMEDOWN>;
			};*/
			//#else
			reg = <0x1300>, <0x800>;
			reg-names = "pon_hlos", "pon_pbs";
			qcom,kpdpwr-sw-debounce;
			qcom,pon_2 {
				qcom,pon-type = <PON_POWER_ON_TYPE_RESIN>;
				linux,code = <KEY_VOLUMEUP>;
			};
			//#endif
	};
};

//lahaina.dtsi
&firmware {
		android {
			vbmeta {
				//#ifndef VENDOR_EDIT
				parts = "vbmeta,boot,system,vendor,dtbo,vendor_boot";
				//#else
				//parts = "vbmeta,boot,system,vendor,dtbo,recovery";
				//#endif /* VENDOR_EDIT */
			};

			fstab {
				vendor {
//#ifndef VENDOR_EDIT
					fsmgr_flags = "wait,slotselect,avb";
//#else
					//fsmgr_flags = "wait,avb";
//#endif /* VENDOR_EDIT */
				};
			};
		};
};


&soc {
	//#ifdef VENDOR_EDIT
	//#ifdef FEATURE_OPLUS_NV_BACKUP
	//add for creating a shared memory with uio for nv backup and restore
	qcom,oembackup_sharedmem@0 {
		compatible = "qcom,sharedmem-uio";
		reg = <0x0 0x280000>;
		reg-names = "oembackup";
		qcom,client-id = <0x00000004>;
	};
	//#endif /* FEATURE_OPLUS_NV_BACKUP */
	//#endif /* VENDOR_EDIT */
	midas_pdev {
                compatible = "oplus,midas-pdev";
        };
};
&ssc_sensors {
//#ifdef VENDOR_EDIT
		vdd-supply = <&pm8350c_l7>;
		vddio-supply = <&pm8350c_l8>;
//#endif
};



//lahaina-audio-overlay.dtsi
&wsa883x_0221 {
/* #ifdef VENDOR_EDIT */
	status = "disabled";
};

&wsa883x_0222 {
/* #ifdef VENDOR_EDIT */
	status = "disabled";
};

&wcd938x_codec {
/* #ifndef VENDOR_EDIT */
		//qcom,cdc-micbias2-mv = <1800>;
/* #else */
		qcom,cdc-micbias2-mv = <2700>;
/* #endif VENDOR_EDIT  */
};

&lahaina_snd {
	qcom,audio-routing =
		"AMIC1", "Analog Mic1",
		"Analog Mic1", "MIC BIAS1",
		"AMIC2", "Analog Mic2",
		"Analog Mic2", "MIC BIAS2",
		"AMIC3", "Analog Mic3",
		"Analog Mic3", "MIC BIAS3",
		"AMIC4", "Analog Mic4",
		"Analog Mic4", "MIC BIAS3",
		"AMIC5", "Analog Mic5",
		"Analog Mic5", "MIC BIAS4",
		"TX DMIC0", "Digital Mic0",
		"TX DMIC0", "MIC BIAS3",
		"TX DMIC1", "Digital Mic1",
/* #ifndef VENDOR_EDIT */
		//"TX DMIC1", "MIC BIAS3",
/* #else */
		"TX DMIC1", "MIC BIAS1",
/* #endif VENDOR_EDIT  */
		"TX DMIC2", "Digital Mic2",
		"TX DMIC2", "MIC BIAS1",
		"TX DMIC3", "Digital Mic3",
/* #ifndef VENDOR_EDIT */
		//"TX DMIC3", "MIC BIAS1",
/* #else */
		"TX DMIC3", "MIC BIAS3",
/* #endif VENDOR_EDIT  */
		"TX DMIC4", "Digital Mic4",
		"TX DMIC4", "MIC BIAS4",
		"TX DMIC5", "Digital Mic5",
		"TX DMIC5", "MIC BIAS4",
		"IN1_HPHL", "HPHL_OUT",
		"IN2_HPHR", "HPHR_OUT",
		"IN3_AUX", "AUX_OUT",
		/*Delete haptics for sound card register issue*/
		//"HAP_IN", "PCM_OUT",
  /* #ifdef VENDOR_EDIT */
		/*"WSA SRC0_INP", "SRC0",
		"TX SWR_INPUT", "SWR_MIC0 SWR_DMIC_OUTPUT",
		"TX SWR_INPUT", "SWR_MIC1 SWR_DMIC_OUTPUT",
		"TX SWR_INPUT", "SWR_MIC2 SWR_DMIC_OUTPUT",
		"TX SWR_INPUT", "SWR_MIC3 SWR_DMIC_OUTPUT",
		"VA SWR_INPUT", "SWR_MIC0 SWR_DMIC_OUTPUT",
		"VA SWR_INPUT", "SWR_MIC1 SWR_DMIC_OUTPUT",
		"VA SWR_INPUT", "SWR_MIC2 SWR_DMIC_OUTPUT",
		"VA SWR_INPUT", "SWR_MIC3 SWR_DMIC_OUTPUT",
		"WSA_TX DEC0_INP", "TX DEC0 MUX",
		"WSA_TX DEC1_INP", "TX DEC1 MUX",*/
  /* #endif VENDOR_EDIT  */
		"RX_TX DEC0_INP", "TX DEC0 MUX",
		"RX_TX DEC1_INP", "TX DEC1 MUX",
		"RX_TX DEC2_INP", "TX DEC2 MUX",
		"RX_TX DEC3_INP", "TX DEC3 MUX",
/* #ifdef VENDOR_EDIT */
		/*"SpkrLeft IN", "WSA_SPK1 OUT",
		"SpkrRight IN", "WSA_SPK2 OUT",*/
/* #endif VENDOR_EDIT  */
		"TX SWR_INPUT", "WCD_TX_OUTPUT",
		"VA SWR_INPUT", "VA_SWR_CLK",
		"VA SWR_INPUT", "WCD_TX_OUTPUT",
		"VA_AIF1 CAP", "VA_SWR_CLK",
		"VA_AIF2 CAP", "VA_SWR_CLK",
		"VA_AIF3 CAP", "VA_SWR_CLK",
		"VA DMIC0", "Digital Mic0",
		"VA DMIC1", "Digital Mic1",
		"VA DMIC2", "Digital Mic2",
		"VA DMIC3", "Digital Mic3",
		"VA DMIC4", "Digital Mic4",
		"VA DMIC5", "Digital Mic5",
		"VA DMIC0", "VA MIC BIAS3",
/* #ifndef VENDOR_EDIT */
		//"VA DMIC1", "VA MIC BIAS3",
/* #else */
		"VA DMIC1", "VA MIC BIAS1",
/* #endif VENDOR_EDIT  */
		"VA DMIC2", "VA MIC BIAS1",
/* #ifndef VENDOR_EDIT */
		//"VA DMIC3", "VA MIC BIAS1",
/* #else */
		"VA DMIC3", "VA MIC BIAS3",
/* #endif VENDOR_EDIT  */
		"VA DMIC4", "VA MIC BIAS4",
		"VA DMIC5", "VA MIC BIAS4";
/* #ifndef VENDOR_EDIT */
	/*qcom,wsa-max-devs = <2>;*/
 /* #else */
	qcom,wsa-max-devs = <0>;
 /* #endif VENDOR_EDIT  */

/* #ifdef VENDOR_EDIT */
	qcom,tert-mi2s-gpios = <&cdc_tert_mi2s_gpios>;
	oplus,speaker-pa = "nxp";
/* #endif VENDOR_EDIT  */
/* #ifdef VENDOR_EDIT */
	qcom,msm-mbhc-hs-mic-max-threshold-mv = <2600>;
	qcom,msm-mbhc-hs-mic-min-threshold-mv = <75>;
	qcom,msm-mbhc-usbc-audio-supported = <1>;
/* #endif VENDOR_EDIT  */
	oplus,mbhc-check-irq-en = <1>;
	oplus,mbhc-headset-micbias-alwayon = <1>;

	/* #ifdef OPLUS_FEATURE_4CH_AEC */
	qcom,afe-rxtx-lb = <1>;
	/* #endif OPLUS_FEATURE_4CH_AEC */

	/*Need to set to NC for use CC detect pin*/
	qcom,msm-mbhc-hphl-swh = <0>;
};


/* #ifdef VENDOR_EDIT */
&cdc_tert_mi2s_gpios {
	compatible = "qcom,msm-cdc-pinctrl";
	pinctrl-names = "aud_active", "aud_sleep";
	pinctrl-0 = <&tert_mi2s_sck_active &tert_mi2s_ws_active &tert_mi2s_sd0_active &tert_mi2s_sd1_active>;
	pinctrl-1 = <&tert_mi2s_sck_sleep &tert_mi2s_ws_sleep &tert_mi2s_sd0_sleep &tert_mi2s_sd1_sleep>;
};
/* #endif VENDOR_EDIT  */

&dai_mi2s2_tx {
	qcom,msm-mi2s-lines = <1>;
};

&dai_mi2s2_rx {
	qcom,msm-mi2s-lines = <2>;
};

/*Add for audio smartPA*/
&qupv3_se19_i2c {
	status = "ok";
	qcom,clk-freq-out = <400000>;
	tfa98xx_34: tfa98xx@34 {
		compatible = "nxp,tfa98xx";
		reg = <0x34>;
		tfa9874_vdd-supply = <&S10B>;
		reset-gpio = <&tlmm 155 0x00>;
		tfa_min_range = <5000>;
		tfa_max_range = <8000>;
		tfa_channel = <0>;
		status = "ok";
	};
	tfa98xx_35: tfa98xx@35 {
		compatible = "nxp,tfa98xx";
		reg = <0x35>;
		tfa9874_vdd-supply = <&S10B>;
		reset-gpio = <&tlmm 154 0x00>;
		tfa_min_range = <5000>;
		tfa_max_range = <8000>;
		tfa_channel = <1>;
		status = "ok";
	};
};

/* #ifdef VENDOR_EDIT */
&fsa4480 {
	compatible = "qcom,fsa4480-i2c";
	status = "ok";
};
/* #endif VENDOR_EDIT  */

/* #ifdef OPLUS_ARCH_EXTENDS */
&swr_dmic_01 {
	status = "disabled";
};

&swr_dmic_02 {
	status = "disabled";
};
&swr_dmic_03 {
	status = "disabled";
};
&swr_dmic_04 {
	status = "disabled";
};
/* #endif OPLUS_ARCH_EXTENDS */

/*Disable haptics for sound card register issue*/
&swr_haptics {
	status = "disabled";
};

/*Disable for not reset GPIO15*/
&wsa_spkr_en1 {
	status = "disabled";
};

/*Disable for not reset GPIO42*/
&wsa_spkr_en2 {
	status = "disabled";
};

/*wsa_macro disable, 'qcom,num-macros' number also need to minus*/
&wsa_macro {
	status = "disabled";
};

&bolero {
	qcom,num-macros = <3>;
};
/*wsa_macro disable end*/

//lahaina-mtp.dtsi

&tlmm {
	s2asl01_switch_active: s2asl01_switch_active {
		mux {
			pins = "gpio6";
			function = "gpio";
		};
		config {
			pins = "gpio6";
			bias-disable; /* NO pull */
			drive-strength = <2>; /* 2 MA */
			output-high;
		};
	};
	charging_inter_active: charging_inter_active {
		mux {
			pins = "gpio90";
			function = "gpio";
		};
		config {
			pins = "gpio90";
			bias-pull-up; /* NO pull */
			drive-strength = <2>; /* 2 MA */
			input-enable;
		};
	};

	charging_inter_sleep: charging_inter_sleep {
		mux {
			pins = "gpio90";
			function = "gpio";
		};
		config {
			pins = "gpio90";
			bias-pull-up; /* NO pull */
			drive-strength = <2>; /* 2 MA */
			input-enable;
		};
	};
	charging_switch1_active: charging_switch1_active {
		mux {
			pins = "gpio27";
			function = "gpio";
		};
		config {
			pins = "gpio27";
			bias-pull-up; /* NO pull */
			drive-strength = <2>; /* 2 MA */
			output-high;
		};
	};

	charging_switch1_sleep: charging_switch1_sleep {
		mux {
			pins = "gpio27";
			function = "gpio";
		};
		config {
			pins = "gpio27";
			bias-pull-up; /* NO pull */
			drive-strength = <2>; /* 2 MA */
			output-low;
		};
	};

	chargerid_switch_active: chargerid_switch_active {
		mux {
			pins = "gpio3";
			function = "gpio";
		};
		config {
			pins = "gpio3";
			bias-pull-up; /* NO pull */
			drive-strength = <2>; /* 2 MA */
			output-high;
		};
	};

	chargerid_switch_sleep: chargerid_switch_sleep {
		mux {
			pins = "gpio3";
			function = "gpio";
		};
		config {
			pins = "gpio3";
			bias-pull-down; /* NO pull */
			drive-strength = <2>; /* 2 MA */
			output-low;
		};
	};

	chargerid_switch_default: chargerid_switch_default {
		mux {
			pins = "gpio3";
			function = "gpio";
		};
		config {
			pins = "gpio3";
			drive-strength = <2>; /* 2 MA */
			bias-disable;
		};
	};
};

&pm8350_gpios {
	//#ifdef OPLUS_FEATRUE_DUAL_SIM_DETECT
	sim2_det_no_pull: sim2_det_no_pull {
			pins = "gpio8";
			function = "normal";
			input-enable;
			power-source = <1>;
			bias-disable;
	};

	sim2_det_pull_high: sim2_det_pull_high {
			pins = "gpio8";
			function = "normal";
			input-enable;
			power-source = <1>;
			bias-pull-up;
	};

	sim2_det_pull_low: sim2_det_pull_low {
			pins = "gpio8";
			function = "normal";
			input-enable;
			power-source = <1>;
			bias-pull-down;
	};
	//#endif OPLUS_FEATRUE_DUAL_SIM_DETECT
};

&soc {

    gpio_keys {
		compatible = "gpio-keys";
		label = "gpio-keys";

		pinctrl-names = "default";
		pinctrl-0 = <&key_vol_down_default>;
		// using volume down config update the default value
		vol_up {
			label = "volume_down";
			gpios = <&pm8350_gpios 6 GPIO_ACTIVE_LOW>;
			linux,input-type = <1>;
			linux,code = <KEY_VOLUMEDOWN>;
			gpio-key,wakeup;
			debounce-interval = <15>;
			linux,can-disable;
		};
	};

	qcom,qbt_handler {
		/delete-property/ qcom,ipc-gpio;
		//#ifdef OPLUS_FEATURE_FINGERPRINT
		status = "disabled";
		//#endif /*OPLUS_FEATURE_FINGERPRINT*/
	};

	extcon_usb1 {
		status = "disabled";
	};

	//#ifdef OPLUS_FEATRUE_SIM_HOLDER_DETECT
	oplus_sim_detect {
		compatible = "oplus, sim_detect";
		Hw,sim_det = "modem_det";
	};
	//#endif /* OPLUS_FEATRUE_SIM_HOLDER_DETECT */

	//#ifdef OPLUS_FEATURE_SENSOR_SMEM
	/*enum sensor_id { OPLUS_ACCEL,OPLUS_GYRO,OPLUS_MAG,OPLUS_LIGHT,OPLUS_PROXIMITY,OPLUS_SAR,OPLUS_CT,OPLUS_BAROMETER,SENSORS_NUM};*/
        sensor_fb: sensor_fb {
            compatible = "oplus,sensor-feedback";
            master-id  = <3>;
            smem-id    = <608>;
        };
	oplus_sensor {
		compatible = "oplus,sensor-devinfo";
		als-row-coe = <270>;
		/*enum {LSM6DSM = 0x01, BMI160 = 0x02, LSM6DS3 = 0x04, BMI260 = 0x08, LSM6DSO = 0x10};*/
		gsensor@0 {
			sensor-name = <0x10>;//LSM6DSO
			sensor-direction = <7>;
			sensor-index = <0>;//source num
			sensor-type = <0>;//OPLUS_ACCEL
			use-sois = <1>;
		};
		/* enum {AKM0991X = 0x01, MMC5x3x = 0x02};*/
		msensor@0 {
			sensor-name = <0x1>;//AKM09918
			sensor-direction = <1>;
			sensor-index = <0>;
			sensor-type = <2>;//OPLUS_MAG
			parameter-number= <18>;
			soft-mag-parameter = <10057 0 397 1 201 1 313 1 9899 0 118 0 235 1 165 0 10532 0>;//e00 sign e01 sign...
		};
		/*enum {STK3A5X=0x01,TCS3701=0x02,TCS3408=0x04};*/
		lsensor@0 {
			sensor-name = <0x04>;
			sensor-index = <0>;
			sensor-type = <3>;//OPLUS_LIGHT
			bus-number = <3>;
			als-type = <2>;
			is-unit-device = <1>;
			is-als-dri = <0>;
			als-factor = <270>;
			als_buffer_length = <8>;
			use_lb_algo = <1>;
		};
		psensor@0 {
			sensor-name = <0x04>;//STK33502
			sensor-index = <0>;
			sensor-type = <4>;//OPLUS_PROXIMITY
			bus-number = <3>;
			irq-number = <89>;
			ps-type = <1>;
			/*1-need close 2-close has contidition 0-not close*/
			is_need_close_pd = <0>;
		};
		/* enum {SX9324 = 0x01, SX9331 = 0x02} */
		sarsensor@0 {
			sensor-name = <0x2>;//SX9331
			sensor-index = <0>;
			sensor-type = <5>;//OPLUS_SAR
			channel-num = <1>;
			is-dc-offset = <1>;
			dc-offset = <1 2 3 4 5 30001 30002 30003 30004 30005>;
		};
		sardownsensor@0 {
			sensor-name = <0x1>;//SX9324
			sensor-index = <0>;
			sensor-type = <9>;// OPLUS_SARS
			parameter-number = <40>;
			sensor-reg = <0x20 0x20 0x24 0x47 0x27 0x47 0x28 0x3d 0x29 0x1f
						0x2a 0x1f 0x2b 0x3d 0x2d 0x08 0x30 0x0b 0x31 0x0b
						0x35 0x00 0x36 0x28 0x37 0xff 0x4a 0x00 0x4d 0x00
						0x4e 0x80 0x4f 0x0c 0x50 0x14 0x52 0x20 0x11 0x23>;
		};
		/* enum {tcs3408 = 0x01  stk37600 = 0x02} */
		cctrsensor@0 {
			sensor-name = <0x2>; //stk37600
			sensor-index = <0>;
			sensor-type = <0x7>; //OPLUS_CCT_REAR
			bus-number = <5>;
			//feature
			publish-sensors = <0x7>; //bit[0] - als, bit[1] - rgb, bit[2] - flicker
			is-ch-dri = <0>;
			timer-size = <25>; //ms
			fac-cali-sensor = <0x2>; //0x1 - als, 0x2 - rgb, 0x4, flicker
		};
		/*virtual sensor
		enum sensor_algo_id {
			OPLUS_PICKUP_DETECT,
			OPLUS_LUX_AOD,
			OPLUS_TP_GESTURE,
			OPLUS_FP_DISPLAY,
			OPLUS_FREE_FALL,
			OPLUS_CAMERA_PROTECT,
			SENSOR_ALGO_NUM
		}*/
		pickup_detect {
			sensor-type = <0>;//OPLUS_PICKUP_DETECT
			is-virtual-sensor;
			is-need-prox = <1>;
			prox-type = <0>;
		};
		lux_aod {
			sensor-type = <1>; //OPLUS_LUX_AOD
			is-virtual-sensor;
			thrd-low = <12>;
			thrd-high = <50>;
			als-type = <1>;
			fold-feature = <1>;
		};
		fp_display {
			sensor-type = <3>;//OPLUS_FP_DISPLAY
			is-virtual-sensor;
			prox-type = <0>; // 0 - proximity; 1 - proximity_fake
		};
		free_fall {
			sensor-type = <4>;//OPLUS_FREE_FALL
			is-virtual-sensor;
		};
		mag_fusion {
			sensor-type = <6>;//OPLUS_MAG_FUSION
			is-virtual-sensor;
			fusion-type = <1>;
			fold-feature = <1>;
		};
	};
	//#endif /*OPLUS_FEATURE_SENSOR_SMEM*/

	//#ifdef OPLUS_FEATURE_FINGERPRINT
	oplus_secure_common {
		compatible = "oplus,secure_common";
		oplus,sec_reg_num = <0x780668>;
		oplus,sec_en_anti_reg = <0x7801CC>;
		oplus,sec_override1_reg = <0x7860C0>;
		oplus,override1_en_value = <0x1>;
	};
	//#endif /*OPLUS_FEATURE_FINGERPRINT*/

	//#ifdef OPLUS_FEATURE_FINGERPRINT
	oplus_fp_common {
		compatible = "oplus,fp_common";
		oplus,fp_gpio_num = <1>;
		oplus,fp_gpio_0 = <&tlmm 119 0x0>;
		pinctrl-names = "default";
		pinctrl-0 = <&gpio_id2_default>;
		goodix3626 {
			oplus,fp-id = <1>; /* fp id mapping table */
			vendor-chip = <16>; /* please refer to the struct fp_vendor_t in oplus_fp_common.n */
			eng-menu = "-1,-1"; /* represents SNR, inclination test item in engineer menu, and 0/1 means off/on */
			chip-name = "G_3626";  /* /proc/fp_id, will be displayed in engineer menu  */
		};
	};
	goodix_fp {
		status = "ok";
		compatible = "goodix,goodix_fp";
		interrupt-parent = <&tlmm>;
		interrupts = <38 0>;
		ldo-supply = <&pm8350c_l11>;
		ldo-config = <3000000 3000000 150000>;
		goodix,gpio_irq = <&tlmm 38 0x1>;
		goodix,gpio_reset = <&tlmm 28 0x0>;
		pinctrl-names = "default";
		pinctrl-0 = <&gpio_goodix_irq_default>;
		notify_tpinfo_flag = <0>;
		power-num = <1>;
		power_source_1 {
			power-mode = <1>;
			power-name = "ldo";
			power-config = "ldo-config";
			delay-time = <0>;
		};
	};
	//#endif /*OPLUS_FEATURE_FINGERPRINT*/
};

//#ifdef OPLUS_FEATURE_TP_BASIC
&qupv3_se4_i2c {
	status = "okay";
	/delete-property/ qcom,i2c-touch-active;

	st_fts@49 {
		status = "disabled";
	};
	focaltech@38 {
		status = "disabled";
	};

	st80y20085_2:st80y20085_2@49{
		compatible = "st,st80y";
		reg = <0x49>;
		chip-name = "ST80Y";
		/* Interrupt && Irq-gpio */
		interrupt-parent = <&tlmm>;
		interrupts = <23 0x2008>;

		/* Power Config */
		vdd_2v8-supply = <&L3C>;
		vcc_1v8-supply = <&L6C>;
		vdd_2v8_volt = <3008000>;
		/* Other HW Resource */

		irq-gpio = <&tlmm 23 0x2008>;
		reset-gpio = <&tlmm 22 0x1>;
		pinctrl-names = "default";
		pinctrl-0 = <&ts_int_active2 &ts_reset_active2>;

		touchpanel,max-num-support = <10>;
		touchpanel,tx-rx-num = <32 34>;
		touchpanel,panel-coords = <19200 17920>;
		touchpanel,display-coords = <1920 1792>;
		touchpanel,touchmajor-limit = <54 54>;
		touchpanel,smooth-level = <0 4 5 6 7 8>;
		touchpanel,smooth-level-charging = <0 4 5 6 7 8>;
		touchpanel,sensitive-level = <0 13 11 9 7 5>;
		touchpanel,sensitive-level-charging = <0 13 11 9 7 5>;
		touchpanel,single-optimized-time = <8>;
		touchpanel,high-frame-rate-time = <60>;

		firmware_name = "0xaa050";
		touchpanel,tp-index = <0>;
		project_id = <20085>;
		vid_len = <2>;
		tp_type = <8>;
		panel_type = <8>;
		// type of tp_dev ,TP-SAMSUNG = 8;
		platform_support_project = <20085>;
		platform_support_project_dir = <20085>;
		platform_support_project_commandline = "dsi_oplus_20085_s6e3_samsung_1792_1920_dsc_cmd";
		panel = <&dsi_oplus_20085_s6e3_samsung_1792_1920_dsc_cmd>;

		/* SW Support Feature Control */
		health_monitor_support;
		exception_upload_support;
		black_gesture_support;
		black_gesture_indep_support;
		sportify_aod_gesture_support;
		charger_pump_support;
		fw_update_app_support;
		smart_gesture_support;
		game_switch_support;
		//kernel_grip_support;
		//fingerprint_underscreen_support;
		//headset_pump_support;
		pressure_report_support;
		irq_need_dev_resume_ok;
		auto_test_need_cal_support;
		freq_hop_simulate_support;
		fw_edge_limit_support;

		/*
		 *Virtual Key Config:
		 *1:touchpanel,button-type: <virtualkey_type  supportted_button-map>
		 *virtualkey_type:
		 *Type 1: using board_properties
		 *Type 2: using same IC (button zone&& touch zone are seprate)
		 *Type 3: using diffrent IC (button zone&& touch zone are seprate)
		 *Type 4: No need of virtual key process
		 *supportted_button-map:select|menu|home|back
		 *
		 *2:touchpanel,button-map
		 *type (X1,Y1)(X2,Y2)(X3,Y3)(Width_X,Hight_Y)--Only when button-type is 0
		 */
		touchpanel,button-type = <4>;
		touchpanel.button-TRx = <0 0>;
	};
};
//#endif /*OPLUS_FEATURE_TP_BASIC*/

//#ifdef OPLUS_FEATURE_TP_BASIC
&qupv3_se8_i2c {
	status = "okay";
	/delete-property/ qcom,i2c-touch-active;

	st_fts@49 {
		status = "disabled";
	};
	focaltech@38 {
		status = "disabled";
	};

	mtp_20085:synaptics20085@4B {
		compatible = "synaptics-s3908";
		reg = <0x4B>;
		chip-name = "S3908";

		/* Interrupt && Irq-gpio */
		interrupt-parent = <&tlmm>;
		interrupts = <99 0x2008>;

		/* Power Config */
		enable2v8_gpio = <&tlmm 78 0x1>;
		//enable1v8_gpio = <&tlmm 6 0x1>;
		//vdd_2v8-supply = <&L3C>;
		vcc_1v8-supply = <&L6C>;
		//vdd_2v8_volt = <3008000>;

		/* Other HW Resource */
		irq-gpio = <&tlmm 99 0x2008>;
		reset-gpio = <&tlmm 42 0x1>;
		pinctrl-names = "default";
		pinctrl-0 = <&ts_int_active &ts_reset_active>;

		touchpanel,max-num-support = <10>;
		touchpanel,tx-rx-num = <15 30>;
		touchpanel,panel-coords = <988 1972>;
		touchpanel,display-coords = <988 1972>;
		touchpanel,touchmajor-limit = <30 45>;
		touchpanel,int-mode = <1>; /*0: interrupt and disable, 1:interrupt and not disable*/
		touchpanel,curved-size = <45>;

		touchpanel,smooth-level = <0 2 4 6 7 9>;
		touchpanel,smooth-level-charging = <0 2 4 7 8 9>;
		touchpanel,sensitive-level = <0 70 55 40 25 10>;
		touchpanel,single-optimized-time = <8>;
		touchpanel,high-frame-rate-time = <60>;

		touchpanel,tp-index = <1>;
		touchpanel,tp_ic_type = <2>;
		panel_type = <3>;
		// type of tp_dev ,TP-SAMSUNG = 8;
		firmware_name = "0x";
		platform_support_project = <20085>;
		platform_support_project_dir = <20085>;
		platform_support_project_commandline = "dsi_oplus_20085_boe_nt37701_988_1972_cmd";
		panel = <&dsi_oplus_20085_boe_nt37701_988_1972_cmd>;

		prevention,curved_screen_V2;
		prevention,grip_disable_level = <6>;
		prevention,updelay_time_ms = <30>;
		prevention,makeup_cnt_weight = <4 1 2 2 2>;
		prevention,large_corner_range = <30 100>;
		prevention,large_corner_judge_condition = <500 100 100 6 6>;
		prevention,trx_reject_condition = <8 7 7>;
		prevention,trx_strict_reject_condition = <8 6 6>;
		prevention,large_judge_time_ms = <500 50 30>;
		prevention,large_exit_condition = <8 8 2>;
		prevention,single_channel_width = <32 32>;
		prevention,normal_tap_condition = <10 300>;
		prevention,long_edge_condition = <200 90 180 80>;
		prevention,long_strict_edge_condition = <160 60>;
		prevention,long_fingerhold_condition = <50 6 4 4>;
		prevention,short_edge_condition = <200 90 180 80>;
		prevention,short_strict_edge_condition = <160 60>;
		prevention,large_strict_exit_condition = <4 4>;
		prevention,top_corner_config = <50 150 48>;
		prevention,edge_swipe_config = <30 100>;

		/* SW Support Feature Control */
		black_gesture_support;
		sportify_aod_gesture_support;
		//fw_edge_limit_support;
		pressure_report_support;
		charger_pump_support;
		game_switch_support;
		smart_gesture_support;
		fw_update_app_support;
		freq_hop_simulate_support;
		report_flow_unlock_support;
		screenoff_fingerprint_info_support;
		irq_need_dev_resume_ok;
		//firmware_in_dts;
		enable_point_auto_change;
		health_monitor_support;
		exception_upload_support;
		black_gesture_indep_support;
		kernel_grip_support;
		temperature_detect_support;
		io-channels = <&pmk8350_vadc PM8350_ADC7_AMUX_THM3_100K_PU>;
		io-channel-names = "pm8350_hot_pocket_therm";
		oplus,skin_temp_chan = "pm8350_hot_pocket_therm";

		/*
		 *Virtual Key Config:
		 *1:touchpanel,button-type: <virtualkey_type  supportted_button-map>
		 *virtualkey_type:
		 *Type 1: using board_properties
		 *Type 2: using same IC (button zone&& touch zone are seprate)
		 *Type 3: using diffrent IC (button zone&& touch zone are seprate)
		 *Type 4: No need of virtual key process
		 *supportted_button-map:select|menu|home|back
		 *
		 *2:touchpanel,button-map
		 *type (X1,Y1)(X2,Y2)(X3,Y3)(Width_X,Hight_Y)--Only when button-type is 0
		 */
		touchpanel,button-type = <4>;
		touchpanel.button-TRx = <0 0>;

		S3908 {
			report_rate_default = <60>;
			report_rate_game_value = <2>;
			default_gesture_mask = <8191>;
			fwupdate_bootloader = <1>;
			normal_config_version = <1>; // oplus grip normal config
			int_check_support = <1>; // int check in probe
		};
	};
};
//#endif /*OPLUS_FEATURE_TP_BASIC*/

&sdhc_2 {
//#ifndef VENDOR_EDIT
//	status = "ok";
//#else
	status = "disabled";
//#endif
};

&qupv3_se2_i2c {
      status = "ok";
      qcom,clk-freq-out = <400000>;
	sc8547-charger@6F{
		status = "okay";
                compatible = "sc,sc8547-master";
                reg = <0x6F 0>;

                qcom,irq_gpio = <&tlmm 90 0x00>;

		pinctrl-names = "switch1_act_switch2_act", "switch1_sleep_switch2_sleep",
					"charging_inter_active", "charging_inter_sleep";
		pinctrl-0 = <&charging_switch1_active>;
		pinctrl-1 = <&charging_switch1_sleep>;
		pinctrl-2 = <&charging_inter_active>;
		pinctrl-3 = <&charging_inter_sleep>;

		ovp_reg = <22>;
		ocp_reg = <12>;
		qcom,service_work_cpu_id = <4>;
		qcom,external_gauge_support;
		qcom,voocphy_current_default = <30>;

		qcom,svooc_cool_down_current_limit = <100 20 20 20 30 40 50 60 70 80 90 100>;
		qcom,vooc_cool_down_current_limit = <60 20 20 20 30 40 50 60>;

		qcom,vooc_multistep_initial_batt_temp = <1000>;
		qcom,vooc_little_cool_temp = <160>;
		qcom,vooc_cool_temp = <120>;
		qcom,vooc_little_cold_temp = <50>;
		qcom,vooc_normal_low_temp = <250>;
		qcom,vooc_strategy_normal_current = <100>;
		qcom,vooc_normal_to_little_cool_current = <100>;
		qcom,vooc_batt_over_high_temp = <510>;
		qcom,vooc-low-temp = <0>;
		qcom,vooc-high-temp = <500>;
		qcom,vooc-low-soc = <0>;
		qcom,vooc-high-soc = <90>;
		qcom,vooc-normal-high-temp = <430>;
		qcom,vooc-warm-allow-vol = <4000>;
		qcom,vooc-warm-allow-soc = <50>;

		qcom,vooc_strategy1_batt_high_temp0 = <385>;
		qcom,vooc_strategy1_batt_high_temp1 = <395>;
		qcom,vooc_strategy1_batt_high_temp2 = <420>;
		qcom,vooc_strategy1_batt_low_temp2 = <410>;
		qcom,vooc_strategy1_batt_low_temp1 = <385>;
		qcom,vooc_strategy1_batt_low_temp0 = <375>;

		qcom,vooc_strategy1_high_current0 = <60>;
		qcom,vooc_strategy1_high_current1 = <60>;
		qcom,vooc_strategy1_high_current2 = <40>;
		qcom,vooc_strategy1_low_current2 = <40>;
		qcom,vooc_strategy1_low_current1 = <60>;
		qcom,vooc_strategy1_low_current0 = <60>;

		qcom,voocphy_ibat_over_current = <11500>;
		qcom,voocphy_cp_max_ibus = <3500>;

		qcom,vooc_little_cold_full_voltage = <4460>;
		qcom,vooc_cool_full_voltage = <4460>;
		qcom,vooc_warm_full_voltage = <4130>;
		qcom,vooc_1time_full_voltage = <4520>;
		qcom,vooc_ntime_full_voltage = <4520>;
		qcom,low_curr_full_t1 = <120>;
		qcom,low_curr_full_t2 = <350>;
		qcom,low_curr_full_t3 = <430>;
		qcom,range1_low_curr_full = <750 4510
			650 4500
			550 4490
			450 4480>;
		qcom,range2_low_curr_full = <850 4510
			750 4500
			650 4490
			550 4480>;

		qcom,sub_range1_low_curr_full = <600 4510
			500 4500
			400 4490
			300 4480>;
		qcom,sub_range2_low_curr_full = <700 4510
			600 4500
			500 4490
			400 4480>;

		qcom,charging_switch1-gpio = <&tlmm 27 0x00>;
		parallel_charge_support;

		svooc_parallel_curve_0 = <30 2800>; // 3000mA
		svooc_parallel_curve_1 = <22 2300>; // 3000mA
		svooc_parallel_curve_2 = <20 1900>; // 3000mA
		svooc_parallel_curve_3 = <10 1400>; // 3000mA

		svooc_batt_sys_curve = <0 0 1 1 1 1 0	// 3000mA
					0 0 0 0 0 0 1	// 3414mV
					0 0 1 0 1 0 0	// 2000mA
					1 1 1 1 1 0 0	// 4550mV
					0 0 0 1 0 1 0	// 1000mA
					1 1 1 1 1 0 0>;	// 4550mV

		vooc_batt_sys_curve =  <0 1 0 1 1 0 1	// 4500mA
					0 0 0 0 0 0 1	// 4604mV
					0 0 1 0 1 0 0	// 2000mA
					1 1 1 0 1 0 1	// 4550mV
					0 0 0 1 0 1 0	// 1000mA
					1 1 1 0 1 0 1>;	// 4550mV

		svooc_charge_strategy {
			strategy_soc_0_to_50 {
				strategy_temp_little_cold =	<4180 15 0 0 0
								 4460 10 1 0 0>;
				strategy_temp_cool =		<4180 20 0 0 0
								 4450 15 0 0 0
								 4460 10 1 0 0>;
				strategy_temp_little_cool = 	<4480 20 0 0 0
								 4500 15 0 0 0
								 4510 10 1 0 0>;
				strategy_temp_normal_low =	<4200 30 0 840 0
								 4480 25 0 1560 0
								 4480 22 0 0 0
								 4480 20 0 0 0
								 4500 15 0 0 0
								 4510 10 1 0 0>;
				strategy_temp_normal_high =	<4200 30 0 840 0
								 4480 25 0 1560 0
								 4480 22 0 0 0
								 4480 20 0 0 0
								 4500 15 0 0 0
								 4510 10 1 0 0>;
				strategy_temp_warm =	<4130 10 1 0 0>;
			};

			strategy_soc_50_to_75 {
				strategy_temp_little_cold =	<4180 15 0 0 0
								 4460 10 1 0 0>;
				strategy_temp_cool =		<4180 20 0 0 0
								 4450 15 0 0 0
								 4460 10 1 0 0>;
				strategy_temp_little_cool =	<4480 20 0 0 0
								 4500 15 0 0 0
								 4510 10 1 0 0>;
				strategy_temp_normal_low =	<4480 25 0 1560 0
								 4480 22 0 0 0
								 4480 20 0 0 0
								 4500 15 0 0 0
								 4510 10 1 0 0>;
				strategy_temp_normal_high =	<4480 25 0 1560 0
								 4480 22 0 0 0
								 4480 20 0 0 0
								 4500 15 0 0 0
								 4510 10 1 0 0>;
				strategy_temp_warm =	<4130 10 1 0 0>;
			};

			strategy_soc_75_to_85 {
				strategy_temp_little_cold = 	<4460 10 1 0 0>;
				strategy_temp_cool =		<4460 10 1 0 0>;
				strategy_temp_little_cool =	<4510 10 1 0 0>;
				strategy_temp_normal_low =	<4500 15 0 0 0
								 4510 10 1 0 0>;
				strategy_temp_normal_high =	<4500 15 0 0 0
								 4510 10 1 0 0>;
				strategy_temp_warm =	<4130 10 1 0 0>;
			};

			strategy_soc_85_to_90 {
				strategy_temp_little_cold = 	<4460 10 1 0 0>;
				strategy_temp_cool =		<4460 10 1 0 0>;
				strategy_temp_little_cool =	<4510 10 1 0 0>;
				strategy_temp_normal_low =	<4510 10 1 0 0>;
				strategy_temp_normal_high =	<4510 10 1 0 0>;
				strategy_temp_warm =	<4130 10 1 0 0>;
			};
		};

		vooc_charge_strategy {
			strategy_soc_0_to_50 {
				strategy_temp_little_cold = 	<4460 20 1 0 0>;
				strategy_temp_cool =		<4450 30 0 0 0
								 4460 20 1 0 0>;
				strategy_temp_little_cool =	<4500 30 0 0 0
								 4510 20 1 0 0>;
				strategy_temp_normal_low =	<4500 30 0 0 0
								 4510 20 1 0 0>;
				strategy_temp_normal_high =	<4500 30 0 0 0
								 4510 20 1 0 0>;
				strategy_temp_warm =	<4130 24 1 0 0>;
			};

			strategy_soc_50_to_75 {
				strategy_temp_little_cold =	<4460 20 1 0 0>;
				strategy_temp_cool =		<4450 30 0 0 0
								 4460 20 1 0 0>;
				strategy_temp_little_cool =	<4500 30 0 0 0
								 4510 20 1 0 0>;
				strategy_temp_normal_low =	<4500 30 0 0 0
								 4510 20 1 0 0>;
				strategy_temp_normal_high =	<4500 30 0 0 0
								 4510 20 1 0 0>;
				strategy_temp_warm =	<4130 24 1 0 0>;
			};

			strategy_soc_75_to_85 {
				strategy_temp_little_cold =	<4460 20 1 0 0>;
				strategy_temp_cool =		<4460 20 1 0 0>;
				strategy_temp_little_cool =	<4510 20 1 0 0>;
				strategy_temp_normal_low =	<4500 30 0 0 0
								 4510 20 1 0 0>;
				strategy_temp_normal_high =	<4500 30 0 0 0
								 4510 20 1 0 0>;
				strategy_temp_warm =	<4130 24 1 0 0>;
			};

			strategy_soc_85_to_90 {
				strategy_temp_little_cold =	<4460 20 1 0 0>;
				strategy_temp_cool =		<4460 20 1 0 0>;
				strategy_temp_little_cool =	<4510 20 1 0 0>;
				strategy_temp_normal_low =	<4510 20 1 0 0>;
				strategy_temp_normal_high =	<4510 20 1 0 0>;
				strategy_temp_warm =	<4130 24 1 0 0>;
			};
		};
	};
};

&qupv3_se1_i2c_pins {
	qupv3_se1_i2c_pulldown: qupv3_se1_i2c_pulldown {
                mux {
                    pins = "gpio8", "gpio9";
                    function = "gpio";
                };

                config {
                    pins = "gpio8", "gpio9";
                    drive-strength = <2>;
                    bias-pull-down;
                    output-low;
                };
	};

	qupv3_se1_i2c_pullup: qupv3_se1_i2c_pullup {
                mux {
                    pins = "gpio8", "gpio9";
                    function = "gpio";
                };

                config {
                    pins = "gpio8", "gpio9";
                    drive-strength = <2>;
                    bias-pull-up;
                    input-enable;
                };
	};
};

&qupv3_se1_i2c {
      status = "ok";
      qcom,clk-freq-out = <100000>;
      pinctrl-names = "default", "sleep", "pulldown", "pullup";
      pinctrl-0 = <&qupv3_se1_i2c_active>;
      pinctrl-1 = <&qupv3_se1_i2c_sleep>;
      pinctrl-2 = <&qupv3_se1_i2c_pulldown>;
      pinctrl-3 = <&qupv3_se1_i2c_pullup>;

      bq27541-battery@55 {
              status = "okay";
              compatible = "oplus,bq27541-battery";
              reg = <0x55>;
              qcom,modify-soc-smooth;
              qcom,gauge_num = <1>;
              //qcom,bq28z610_need_balancing;
              oplus,capacity-pct = <46>;
              qcom,zy0602_version_2112;
      };
};

&qupv3_se11_i2c_pins {
	qupv3_se11_i2c_pulldown: qupv3_se11_i2c_pulldown {
                mux {
                    pins = "gpio48", "gpio49";
                    function = "gpio";
                };

                config {
                    pins = "gpio48", "gpio49";
                    drive-strength = <2>;
                    bias-pull-down;
                    output-low;
                };
	};

	qupv3_se11_i2c_pullup: qupv3_se11_i2c_pullup {
                mux {
                    pins = "gpio48", "gpio49";
                    function = "gpio";
                };

                config {
                    pins = "gpio48", "gpio49";
                    drive-strength = <2>;
                    bias-pull-up;
                    input-enable;
                };
	};
};

&qupv3_se11_i2c {
	status = "ok";
	qcom,clk-freq-out = <100000>;
	pinctrl-names = "default", "sleep", "pulldown", "pullup";
	pinctrl-0 = <&qupv3_se11_i2c_active>;
	pinctrl-1 = <&qupv3_se11_i2c_sleep>;
	pinctrl-2 = <&qupv3_se11_i2c_pulldown>;
	pinctrl-3 = <&qupv3_se11_i2c_pullup>;

	bq27541-battery@55 {
		status = "okay";
		compatible = "oplus,bq27541-battery";
		reg = <0x55>;
		qcom,modify-soc-smooth;
		//qcom,bq28z610_need_balancing;
		oplus,capacity-pct = <54>;
		qcom,zy0602_version_2112;
	};
};

//#endif

&thermal_zones {
	tof-therm-usr {
		status = "disabled";
	};
};

&pm8350b_haptics {
	status = "disabled";
};


&usb1 {
	/delete-property/ extcon;
	status = "disabled";
	dwc3@a800000 {
		status = "disabled";
	};

//#endif
};

//#ifdef OPLUS_FEATURE_FINGERPRINT
&removed_mem {
	no-map;
	//reg = <0x0 0xd8800000 0x0 0x9800000>;
	reg = <0x0 0xd8800000 0x0 0x8e00000>;
};
&splash_memory {
	//reg = <0x0 0xe5700000 0x0 0x02300000>;
	reg = <0x0 0xe4d00000 0x0 0x02300000>;
	label = "cont_splash_region";
};

&disp_rdump_memory {
	//reg = <0xe5700000 0x00800000>;
	reg = <0xe4d00000 0x00800000>;
	label = "disp_rdump_region";
};

&dfps_data_memory {
	//reg = <0x0 0xe7a00000 0x0 0x0100000>;
	reg = <0x0 0xe7000000 0x0 0x0100000>;
	label = "dfps_data_region";
};
//#endif /*OPLUS_FEATURE_FINGERPRINT*/

// #ifdef OPLUS_SYSTEM_UBOOT_LOG
// xbl_uefi_mem address get from boot_images Core.dsc.inc file: PcdEmbeddedFdBaseAddress + SERIAL_BUFFER_OFFSET,0x9FE00000+0x1F7000=0x9FFF7000
// kernel boot log: 0x9FE00000~ 0x9FFF7000
&reserved_memory {
		kboot_uboot_logmem: kboot_uboot_logmem@0x9FE00000 {
			reg = <0x0 0x9FE00000 0x0 0x200000>;
			compatible = "oplus,xbl_uefi_kbootlog";
			xbluefi-offset = <0x1F7000>;
			no-map;
		};
//#if IS_ENABLED(CONFIG_OPLUS_FEATURE_DUMP_DEVICE_INFO)
    ramoops: ramoops@0xE9700000 {
        compatible = "ramoops";
        reg = <0 0xE9700000 0 0x05B8000>; //5M + 736k
        record-size =  <0x40000>; //256k
        console-size = <0x40000>; //256k
        ftrace-size =  <0x200000>; //2M
        pmsg-size=     <0x200000>; //2M
        devinfo-size=  <0x08000>;  //32k
        dumpinfo-size=  <0x08000>; //32k
        rsv01info-size=  <0x08000>; //32k
        rsv02info-size=  <0x08000>; //32k
        rsv03info-size=  <0x08000>; //32k
        rsv04info-size=  <0x08000>; //32k
        rsv05info-size=  <0x08000>; //32k
        ecc-size=      <0x0>;
    };
//#endif
};
// #endif

//#ifdef OPLUS_BUG_STABILITY
&wlan {
	use-nv-mac;
};
//#endif /* OPLUS_BUG_STABILITY */

//#ifdef VENDOR_EDIT
&soc {
	devinfo {
		compatible = "oplus-devinfo";

		//pinctrl-names = "active", "sleep";
		//pinctrl-0 = <&hw_id_active>;
		//pinctrl-1 = <&hw_id_sleep>;

		io-channels= <&pmk8350_vadc PM8350_ADC7_GPIO1>;
		io-channel-names= "vph_pwr_voltage_sub";

		main-sub {
			compatible = "hw-match, main-sub";
			use_pmic_adc;
			adc_ranges = <0 80
					81 180
					181 300
					301 420
					421 550
					551 650
					651 760
					761 850
					851 950
					951 1050
					1051 1150
					1151 1300>;
			aboard-patterns = <0 1>;

			/*main board*/
			match-projects = <20085 20085>;

			/*rf type*/
			//rf_match_support;
			//rf-patterns = <0 1>;
		};
	};
	//#ifdef OPLUS_FEATURE_RF_CABLE_DETECT
	oplus_rf_cable {
		compatible = "oplus,rf_cable";
		interrupt-parent = <&tlmm>;
		rf_cable_support_num = <1>;
		rf,cable0-gpio = <&tlmm 91 0>;
		rf,cable-support-timer = <0>;
		pinctrl-names = "rf_cable_active";
		pinctrl-0 = <&rf_cable0_active>;
	};
	//#endif /* OPLUS_FEATURE_RF_CABLE_DETECT */
};
//#endif /*VENDOR_EDIT*/

//#ifdef OPLUS_FEATURE_CHG_BASIC
&usb0 {
	dwc3@a600000 {
		snps,usb2-lpm-disable;
	};
};
//#endif /* OPLUS_FEATURE_CHG_BASIC */

//#ifdef OPLUS_FEATURE_THERMAL
&thermal_zones {
	cpu-gold-0-0-step {
		polling-delay-passive = <10>;
		polling-delay = <0>;
		thermal-sensors = <&tsens0 7>;
		thermal-governor = "step_wise";
		trips {
			cg00_config: cg00-config {
				temperature = <85000>;
				hysteresis = <3000>;
				type = "passive";
			};
		};

		cooling-maps {
			cg00_cdev {
				trip = <&cg00_config>;
				cooling-device = <&CPU4 THERMAL_NO_LIMIT
							(THERMAL_MAX_LIMIT - 8)>;
			};
		};
	};

	cpu-gold-0-1-step {
		polling-delay-passive = <10>;
		polling-delay = <0>;
		thermal-sensors = <&tsens0 8>;
		thermal-governor = "step_wise";
		trips {
			cg01_config: cg01-config {
				temperature = <85000>;
				hysteresis = <3000>;
				type = "passive";
			};
		};

		cooling-maps {
			cg01_cdev {
				trip = <&cg01_config>;
				cooling-device = <&CPU4 THERMAL_NO_LIMIT
							(THERMAL_MAX_LIMIT - 8)>;
			};
		};
	};

	cpu-gold-1-0-step {
		polling-delay-passive = <10>;
		polling-delay = <0>;
		thermal-sensors = <&tsens0 9>;
		thermal-governor = "step_wise";
		trips {
			cg10_config: cg10-config {
				temperature = <85000>;
				hysteresis = <3000>;
				type = "passive";
			};
		};

		cooling-maps {
			cg10_cdev {
				trip = <&cg10_config>;
				cooling-device = <&CPU5 THERMAL_NO_LIMIT
							(THERMAL_MAX_LIMIT - 8)>;
			};
		};
	};

	cpu-gold-1-1-step {
		polling-delay-passive = <10>;
		polling-delay = <0>;
		thermal-sensors = <&tsens0 10>;
		thermal-governor = "step_wise";
		trips {
			cg11_config: cg11-config {
				temperature = <85000>;
				hysteresis = <3000>;
				type = "passive";
			};
		};

		cooling-maps {
			cg11_cdev {
				trip = <&cg11_config>;
				cooling-device = <&CPU4 THERMAL_NO_LIMIT
							(THERMAL_MAX_LIMIT - 8)>;
			};
		};
	};

	cpu-gold-2-0-step {
		polling-delay-passive = <10>;
		polling-delay = <0>;
		thermal-sensors = <&tsens0 11>;
		thermal-governor = "step_wise";
		trips {
			cg20_config: cg20-config {
				temperature = <85000>;
				hysteresis = <3000>;
				type = "passive";
			};
		};

		cooling-maps {
			cg20_cdev {
				trip = <&cg20_config>;
				cooling-device = <&CPU4 THERMAL_NO_LIMIT
							(THERMAL_MAX_LIMIT - 8)>;
			};
		};
	};

	cpu-gold-2-1-step {
		polling-delay-passive = <10>;
		polling-delay = <0>;
		thermal-sensors = <&tsens0 12>;
		thermal-governor = "step_wise";
		trips {
			cg21_config: cg21-config {
				temperature = <85000>;
				hysteresis = <3000>;
				type = "passive";
			};
		};

		cooling-maps {
			cg21_cdev {
				trip = <&cg21_config>;
				cooling-device = <&CPU4 THERMAL_NO_LIMIT
							(THERMAL_MAX_LIMIT - 8)>;
			};
		};
	};

	cpu-gold-3-0-step {
		polling-delay-passive = <10>;
		polling-delay = <0>;
		thermal-sensors = <&tsens0 13>;
		thermal-governor = "step_wise";
		trips {
			cg30_config: cg30-config {
				temperature = <85000>;
				hysteresis = <3000>;
				type = "passive";
			};
		};

		cooling-maps {
			cg30_cdev {
				trip = <&cg30_config>;
				cooling-device = <&CPU7 THERMAL_NO_LIMIT
							(THERMAL_MAX_LIMIT - 8)>;
			};
		};
	};

	cpu-gold-3-1-step {
		polling-delay-passive = <10>;
		polling-delay = <0>;
		thermal-sensors = <&tsens0 14>;
		thermal-governor = "step_wise";
		trips {
			cg31_config: cg31-config {
				temperature = <85000>;
				hysteresis = <3000>;
				type = "passive";
			};
		};

		cooling-maps {
			cg31_cdev {
				trip = <&cg31_config>;
				cooling-device = <&CPU7 THERMAL_NO_LIMIT
							(THERMAL_MAX_LIMIT - 8)>;
			};
		};
	};
};

&ibat_lvl0 {
	temperature = <7500>;
	hysteresis = <200>;
	type = "passive";
};
&ibat_lvl1 {
	temperature = <10000>;
	hysteresis = <200>;
	type = "passive";
};
//#endif OPLUS_FEATURE_THERMAL

&tlmm {
	gpio_wakeup: gpio_wakeup {
		compatible = "gpio_wakeup";
		gpio_table = <14 15 35 36 39
		             43 44 50 55 67 84
		             88 92 98 115 117 119 156 157
		             162 165 169 172 174 175 177 180 185 198>;
	};
};
