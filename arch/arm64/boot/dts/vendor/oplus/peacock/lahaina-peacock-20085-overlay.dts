#include "../../qcom/lahaina-mtp-overlay.dts"
#include "lahaina-camera-sensor-20085.dtsi"
#include "peacock-common.dtsi"
#include "peacock-20085_EVT2.dtsi"
#include "nfc/peacock-nfc-sn100t.dtsi"

/ {
	model = "Qualcomm Technologies, Inc. Lahaina MTP";
	compatible = "qcom,lahaina-mtp", "qcom,lahaina", "qcom,mtp";
	qcom,board-id = <0x10008 0>;
	oplus,dtsi_no = <20085>;
};
