&mdss_mdp {
	dsi_oplus21075_ds_ili7807s_1080_2412_120fps_vid: qcom,mdss_dsi_oplus21075_ds_ili7807s_1080_2412_120fps_vid {
		qcom,mdss-dsi-panel-name =
			"21075 ds ili7807s fhd tft lcd panel with dsc";
		qcom,mdss-dsi-panel-type = "dsi_video_mode";
		qcom,dsi-ctrl-num = <0>;
		qcom,dsi-phy-num = <0>;
		qcom,mdss-dsi-virtual-channel-id = <0>;
		qcom,mdss-dsi-stream = <0>;
		qcom,mdss-dsi-bpp = <24>;
		qcom,mdss-dsi-color-order = "rgb_swap_rgb";
		qcom,mdss-dsi-underflow-color = <0xff>;
		qcom,mdss-dsi-border-color = <0>;

		qcom,mdss-dsi-traffic-mode = "burst_mode";
		qcom,mdss-dsi-bllp-power-mode;
		qcom,mdss-dsi-bllp-eof-power-mode;
		qcom,mdss-dsi-lane-0-state;
		qcom,mdss-dsi-lane-1-state;
		qcom,mdss-dsi-lane-2-state;
		qcom,mdss-dsi-lane-3-state;
		qcom,mdss-dsi-dma-trigger = "trigger_sw";
		qcom,mdss-dsi-mdp-trigger = "none";
		qcom,mdss-dsi-reset-sequence = <1 5>, <0 10>, <1 15>;

		qcom,mdss-dsi-wr-mem-start = <0x2C>;
		qcom,mdss-dsi-wr-mem-continue = <0x3C>;

		qcom,bl-update-flag = "delay_until_first_frame";
		qcom,mdss-dsi-init-delay-us = <1000>;
		qcom,mdss-dsi-lp11-init;
		qcom,ulps-enabled;
		qcom,suspend-ulps-enabled;

		qcom,mdss-dsi-te-pin-select = <1>;
		qcom,mdss-dsi-te-dcs-command = <1>;
		qcom,mdss-dsi-te-check-enable;
		qcom,mdss-dsi-te-using-te-pin;

		qcom,mdss-pan-physical-width-dimension = <68>;
		qcom,mdss-pan-physical-height-dimension = <153>;

		qcom,mdss-dsi-display-timings {
			timing@0 {
				//qcom,mdss-mdp-transfer-time-us = <7000>;
				qcom,mdss-dsi-panel-framerate = <120>;
				qcom,mdss-dsi-panel-width = <1080>;
				qcom,mdss-dsi-panel-height = <2412>;
				qcom,mdss-dsi-h-front-porch = <120>;
				qcom,mdss-dsi-h-back-porch = <116>;
				qcom,mdss-dsi-h-pulse-width = <20>;
				qcom,mdss-dsi-h-sync-skew = <0>;
				qcom,mdss-dsi-v-front-porch = <40>;
				qcom,mdss-dsi-v-back-porch = <36>;
				qcom,mdss-dsi-v-pulse-width = <4>;
				qcom,mdss-dsi-on-command = [
					39 01 00 00 00 00 04 FF 78 07 06
					15 01 00 00 00 00 02 08 20
					39 01 00 00 00 00 04 FF 78 07 03
					15 01 00 00 00 00 02 83 20
					15 01 00 00 00 00 02 84 01

					39 01 00 00 00 00 04 FF 78 07 03
					15 01 00 00 00 00 02 86 47
					15 01 00 00 00 00 02 87 56
					15 01 00 00 00 00 02 AF 18
					15 01 00 00 00 00 02 8C E2
					15 01 00 00 00 00 02 8D E3
					15 01 00 00 00 00 02 8E E5
					15 01 00 00 00 00 02 8F E6
					15 01 00 00 00 00 02 90 E9
					15 01 00 00 00 00 02 91 EB
					15 01 00 00 00 00 02 92 EE
					15 01 00 00 00 00 02 93 F0
					15 01 00 00 00 00 02 94 F6
					15 01 00 00 00 00 02 95 FA

					15 01 00 00 00 00 02 96 BF
					15 01 00 00 00 00 02 97 C4
					15 01 00 00 00 00 02 98 C7
					15 01 00 00 00 00 02 99 C9
					15 01 00 00 00 00 02 9A CF
					15 01 00 00 00 00 02 9B D4
					15 01 00 00 00 00 02 9C DA
					15 01 00 00 00 00 02 9D E2
					15 01 00 00 00 00 02 9E EB
					15 01 00 00 00 00 02 9F FA

					39 01 00 00 00 00 04 FF 78 07 06
					15 01 00 00 00 00 02 3E E2
					15 01 00 00 00 00 02 48 0F
					15 01 00 00 00 00 02 4D 80
					15 01 00 00 00 00 02 4E 40
					15 01 00 00 00 00 02 C7 05

					39 01 00 00 00 00 04 FF 78 07 00
					15 01 00 00 00 00 02 53 2C
					15 01 00 00 00 00 02 55 02
					15 01 00 00 00 00 02 35 00
					39 01 00 00 00 00 03 51 0F FF
					05 01 00 00 50 00 01 11

					39 01 00 00 00 00 04 FF 78 07 17
					39 01 00 00 00 00 86 20
						00 00 00 00 00 11 00 00
						89 30 80 09 6C 04 38 00
						0C 02 1C 02 1C 02 00 02
						0E 00 20 01 1F 00 07 00
						0C 08 BB 08 7A 18 00 10
						F0 03 0C 20 00 06 0B 0B
						33 0E 1C 2A 38 46 54 62
						69 70 77 79 7B 7D 7E 01
						02 01 00 09 40 09 BE 19
						FC 19 FA 19 F8 1A 38 1A
						78 1A B6 2A F6 2B 34 2B
						74 3B 74 6B F4 00 00 00
						00 00 00 00 00 00 00 00
						00 00 00 00 00 00 00 00
						00 00 00 00 00 00 00 00
						00 00 00 00 00 00 00 00
						00 00 00 00 00
					/* Digtial SSC Setting */
					39 01 00 00 00 00 04 FF 78 07 0B
					15 01 00 00 00 00 02 E7 4B
					15 01 00 00 00 00 02 E8 03

					/* Support LCD120/TP240 */
					39 01 00 00 00 00 04 FF 78 07 11
					15 01 00 00 00 00 02 00 01
					15 01 00 00 00 00 02 03 07
					39 01 00 00 00 00 04 FF 78 07 0E
					15 01 00 00 00 00 02 21 2E
					15 01 00 00 00 00 02 23 2E
					15 01 00 00 00 00 02 20 03
					15 01 00 00 00 00 02 25 11
					15 01 00 00 00 00 02 26 24
					15 01 00 00 00 00 02 27 20
					15 01 00 00 00 00 02 29 58
					15 01 00 00 00 00 02 2D 5B
					15 01 00 00 00 00 02 41 17
					15 01 00 00 00 00 02 43 17
					39 01 00 00 00 00 04 FF 78 07 1E
					15 01 00 00 00 00 02 00 2E
					15 01 00 00 00 00 02 08 2E
					15 01 00 00 00 00 02 09 2E
					15 01 00 00 00 00 02 A4 1D
					15 01 00 00 00 00 02 A5 7F
					15 01 00 00 00 00 02 A6 7F
					15 01 00 00 00 00 02 A7 53

					39 01 00 00 00 00 04 FF 78 07 02
					15 01 00 00 00 00 02 1B 00	// FR_sel:FPS/TP [00:120/180 01:144/144 02:60/180]
					39 01 00 00 00 00 04 FF 78 07 04
					15 01 00 00 00 00 02 BD 01	// GRAM Arbiter reset

					39 01 00 00 00 00 04 FF 78 07 00
					05 01 00 00 14 00 01 29
					39 01 00 00 00 00 04 FF 78 07 0F
					];

				qcom,mdss-dsi-off-command = [
					39 01 00 00 00 00 04 FF 78 07 00
					05 01 00 00 14 00 01 28
					05 01 00 00 78 00 01 10];
				qcom,mdss-dsi-post-panel-on-command =[
					39 01 00 00 00 00 04 FF 78 07 00
				];
				qcom,mdss-dsi-cabc-off-command = [
					39 01 00 00 00 00 04 FF 78 07 00
					15 01 00 00 00 00 02 53 2C
					15 01 00 00 00 00 02 55 00
					39 01 00 00 00 00 04 FF 78 07 0F];
				qcom,mdss-dsi-cabc-ui-command = [
					39 01 00 00 00 00 04 FF 78 07 00
					15 01 00 00 00 00 02 53 2C
					15 01 00 00 00 00 02 55 02
					39 01 00 00 00 00 04 FF 78 07 0F];
				qcom,mdss-dsi-cabc-still-image-command = [
					39 01 00 00 00 00 04 FF 78 07 00
					15 01 00 00 00 00 02 53 2C
					15 01 00 00 00 00 02 55 03
					39 01 00 00 00 00 04 FF 78 07 0F];
				qcom,mdss-dsi-cabc-video-command = [
					39 01 00 00 00 00 04 FF 78 07 00
					15 01 00 00 00 00 02 53 2C
					15 01 00 00 00 00 02 55 03
					39 01 00 00 00 00 04 FF 78 07 0F];

				qcom,mdss-dsi-on-command-state = "dsi_lp_mode";
				qcom,mdss-dsi-off-command-state = "dsi_lp_mode";
				qcom,mdss-dsi-post-panel-on-command-state="dsi_lp_mode";
				qcom,mdss-dsi-cabc-off-command-state = "dsi_lp_mode";
				qcom,mdss-dsi-cabc-ui-command-state = "dsi_lp_mode";
				qcom,mdss-dsi-cabc-still-image-command-state = "dsi_lp_mode";
				qcom,mdss-dsi-cabc-video-command-state = "dsi_lp_mode";

				qcom,compression-mode = "dsc";
				qcom,mdss-dsc-slice-height = <12>;
				qcom,mdss-dsc-slice-width = <540>;
				qcom,mdss-dsc-slice-per-pkt = <2>;
				qcom,mdss-dsc-bit-per-component = <8>;
				qcom,mdss-dsc-bit-per-pixel = <8>;
				qcom,mdss-dsc-block-prediction-enable;
			};
		};
	};
};

&dsi_oplus21075_ds_ili7807s_1080_2412_120fps_vid {
	oplus,mdss-dsi-manufacture = "DS";
	oplus,mdss-dsi-vendor-name = "ILI7807S";
	oplus,mdss-dsi-pre-bl-delay-enabled;
	oplus,mdss-dsi-pre-bl-delay-ms = <30>;
	oplus,mdss-dsi-cabc-enabled;

	qcom,panel-supply-entries = <&dsi_panel_pwr_supply_labibb>;
	qcom,mdss-dsi-bl-pmic-control-type = "bl_ctrl_wled";
	qcom,mdss-dsi-bl-min-level = <1>;
	qcom,mdss-dsi-bl-max-level = <4095>;
	qcom,mdss-brightness-max-level = <4095>;
	qcom,mdss-dsi-bl-normal-max-level = <3276>;
	qcom,mdss-brightness-normal-max-level = <3276>;
	qcom,mdss-brightness-default-level = <891>;
	qcom,platform-te-gpio = <&tlmm 80 0>;
	qcom,platform-reset-gpio = <&tlmm 44 0>;
	qcom,dsi-select-clocks = "mux_byte_clk0", "mux_pixel_clk0",
		"src_byte_clk0", "src_pixel_clk0",
		"shadow_byte_clk0", "shadow_pixel_clk0";

	qcom,esd-check-enabled;
	qcom,mdss-dsi-panel-status-check-mode = "reg_read";
	qcom,mdss-dsi-panel-status-command = [06 01 00 01 00 00 01 09];
	qcom,mdss-dsi-panel-status-command-state = "dsi_lp_mode";
	qcom,mdss-dsi-panel-status-value = <0x80 0x03 0x06>;
	qcom,mdss-dsi-panel-status-read-length = <3>;

	qcom,mdss-dsi-pan-enable-dynamic-fps;
	qcom,mdss-dsi-pan-fps-update = "dfps_immediate_porch_mode_vfp";
	qcom,dsi-supported-dfps-list = <120 90 60 50 48 45 30>;
	qcom,mdss-dsi-qsync-min-refresh-rate = <30>;

	//qcom,dsi-dyn-clk-enable;
	//qcom,dsi-dyn-clk-type = "constant-fps-adjust-vfp";
	//qcom,dsi-dyn-clk-list = <901327680 893816616 897572152>;

	qcom,mdss-dsi-t-clk-post = <0x0F>;
	qcom,mdss-dsi-t-clk-pre = <0x1E>;
	qcom,mdss-dsi-display-timings {
		timing@0 {
			qcom,mdss-dsi-panel-clockrate = <1107000000>;
			qcom,mdss-dsi-panel-phy-timings = [00 24 0A 0A 1A 18 0A
				0A 09 02 04 00 1E 0F];
			qcom,display-topology = <1 1 1>;
			qcom,default-topology-index = <0>;
		};
	};
};

&dsi_oplus21075_ds_ili7807s_1080_2412_120fps_vid {
	qcom,panel_voltage_vddi_name = "vddio";
	qcom,panel_voltage_vddi = <0 1650000 1800000 1950000>;
	qcom,panel_voltage_vddr_name = "vddio";
	qcom,panel_voltage_vddr = <1 1650000 1800000 1950000>;
};

