&mdss_mdp {
	dsi_oplus21643_ds_ili7807s_1080_2412_120fps_vid: qcom,mdss_dsi_oplus21643_ds_ili7807s_1080_2412_120fps_vid {
		qcom,mdss-dsi-panel-name =
			"21643 ds ili7807s fhd tft lcd panel with dsc";
		qcom,mdss-dsi-panel-type = "dsi_video_mode";
		qcom,dsi-ctrl-num = <0>;
		qcom,dsi-phy-num = <0>;
		qcom,mdss-dsi-virtual-channel-id = <0>;
		qcom,mdss-dsi-stream = <0>;
		qcom,mdss-dsi-bpp = <24>;
		qcom,mdss-dsi-color-order = "rgb_swap_rgb";
		qcom,mdss-dsi-underflow-color = <0xff>;
		qcom,mdss-dsi-border-color = <0>;

		qcom,mdss-dsi-traffic-mode = "burst_mode";
		qcom,mdss-dsi-bllp-power-mode;
		qcom,mdss-dsi-bllp-eof-power-mode;
		qcom,mdss-dsi-lane-0-state;
		qcom,mdss-dsi-lane-1-state;
		qcom,mdss-dsi-lane-2-state;
		qcom,mdss-dsi-lane-3-state;
		qcom,mdss-dsi-dma-trigger = "trigger_sw";
		qcom,mdss-dsi-mdp-trigger = "none";
		qcom,mdss-dsi-reset-sequence = <1 5>, <0 10>, <1 15>;

		qcom,mdss-dsi-wr-mem-start = <0x2C>;
		qcom,mdss-dsi-wr-mem-continue = <0x3C>;

		qcom,bl-update-flag = "delay_until_first_frame";
		qcom,mdss-dsi-init-delay-us = <1000>;
		qcom,mdss-dsi-lp11-init;
		qcom,ulps-enabled;
		qcom,suspend-ulps-enabled;

		qcom,mdss-dsi-te-pin-select = <1>;
		qcom,mdss-dsi-te-dcs-command = <1>;
		qcom,mdss-dsi-te-check-enable;
		qcom,mdss-dsi-te-using-te-pin;

		qcom,mdss-pan-physical-width-dimension = <71>;
		qcom,mdss-pan-physical-height-dimension = <152>;

		qcom,mdss-dsi-display-timings {
			timing@0 {
				//qcom,mdss-mdp-transfer-time-us = <7000>;
				qcom,mdss-dsi-panel-framerate = <144>;
				qcom,mdss-dsi-panel-width = <1080>;
				qcom,mdss-dsi-panel-height = <2412>;
				qcom,mdss-dsi-h-front-porch = <76>;
				qcom,mdss-dsi-h-back-porch = <60>;
				qcom,mdss-dsi-h-pulse-width = <18>;
				qcom,mdss-dsi-h-sync-skew = <0>;
				qcom,mdss-dsi-v-back-porch = <36>;
				qcom,mdss-dsi-v-front-porch = <34>;
				qcom,mdss-dsi-v-pulse-width = <10>;
				qcom,mdss-dsi-on-command = [
					39 01 00 00 00 00 04 FF 78 07 06
					15 01 00 00 00 00 02 08 20
					39 01 00 00 00 00 04 FF 78 07 03
					15 01 00 00 00 00 02 81 14
					15 01 00 00 00 00 02 82 15
					15 01 00 00 00 00 02 83 20
					15 01 00 00 00 00 02 84 01

					39 01 00 00 00 00 04 FF 78 07 03
					15 01 00 00 00 00 02 88 CC  //Black 80%
					15 01 00 00 00 00 02 89 E5  //grey 89.84%
					15 01 00 00 00 00 02 8A ED  //fruit 92.97%
					15 01 00 00 00 00 02 8B EF
					15 01 00 00 00 00 02 B3 E5  //desktop 89.84%
					15 01 00 00 00 00 02 AC FA  //white 98%

					15 01 00 00 00 00 02 AD E0  //white 87.89%
					15 01 00 00 00 00 02 8C 9B  //black 60.94%
					15 01 00 00 00 00 02 8D A9
					15 01 00 00 00 00 02 8E AD
					15 01 00 00 00 00 02 8F AF
					15 01 00 00 00 00 02 90 B2  //grey 69.92%
					15 01 00 00 00 00 02 91 BC
					15 01 00 00 00 00 02 92 BD
					15 01 00 00 00 00 02 93 BA
					15 01 00 00 00 00 02 94 CA
					15 01 00 00 00 00 02 95 D5  //fruit 73%->83.6%
					15 01 00 00 00 00 02 B4 D9  //desktop 71%->85.2%

					15 01 00 00 00 00 02 AE D3  //white 82.81%
					15 01 00 00 00 00 02 96 70  //black 44.14%
					15 01 00 00 00 00 02 97 97  //L4-L19
					15 01 00 00 00 00 02 98 99
					15 01 00 00 00 00 02 99 9F
					15 01 00 00 00 00 02 9A A3  //grey 64%
					15 01 00 00 00 00 02 9B A6
					15 01 00 00 00 00 02 9C A9
					15 01 00 00 00 00 02 9D AD
					15 01 00 00 00 00 02 9E C2
					15 01 00 00 00 00 02 9F CC  //fruit 67.97%->80%
					15 01 00 00 00 00 02 B5 D0  //desktop 64.84%->81%

					15 01 00 00 00 00 02 A0 C0
					15 01 00 00 00 00 02 A1 7E  //threshold
					15 01 00 00 00 00 02 A2 7E  //threshold Highlight moving
					15 01 00 00 00 00 02 A7 E5  //Highlight PWM
					15 01 00 00 00 00 02 A8 E5  //Highlight PWM
					15 01 00 00 00 00 02 B6 00
					15 01 00 00 00 00 02 B7 D0
					15 01 00 00 00 00 02 B8 D0
					15 01 00 00 00 00 02 B1 66
					15 01 00 00 00 00 02 B2 66
					15 01 00 00 00 00 02 86 6C
					15 01 00 00 00 00 02 87 6C


					39 01 00 00 00 00 04 FF 78 07 06
					15 01 00 00 00 00 02 3E E2
					15 01 00 00 00 00 02 48 0F
					15 01 00 00 00 00 02 4D 80
					15 01 00 00 00 00 02 4E 40
					15 01 00 00 00 00 02 C7 05

					39 01 00 00 00 00 04 FF 78 07 1E
					15 01 00 00 00 00 02 B5 8A
					15 01 00 00 00 00 02 B6 8A

					39 01 00 00 00 00 04 FF 78 07 00
					39 01 00 00 00 00 03 51 0F FF
					15 01 00 00 00 00 02 53 24
					15 01 00 00 00 00 02 55 01
					15 01 00 00 00 00 02 35 00
					05 01 00 00 50 00 01 11

					39 01 00 00 00 00 04 FF 78 07 08
					39 01 00 00 00 00 20 E0 00 00 1D
						4A 00 8A B7 DB 15 13 3C 7D 25
						AA F3 29 2A 60 9E C5 3E F8 1C
						48 3F 60 85 B5 0F D7 D9
					39 01 00 00 00 00 20 E1 00 00 1D
						4A 00 8A B7 DB 15 13 3C 7D 25
						AA F3 29 2A 60 9E C5 3E F8 1C
						48 3F 60 85 B5 0F D7 D9

					39 01 00 00 00 00 04 FF 78 07 17
					39 01 00 00 00 00 86 20
						00 00 00 00 00 11 00 00 89 30
						80 09 6C 04 38 00 0C 02 1C 02
						1C 02 00 02 0E 00 20 01 1F 00
						07 00 0C 08 BB 08 7A 18 00 10
						F0 03 0C 20 00 06 0B 0B 33 0E
						1C 2A 38 46 54 62 69 70 77 79
						7B 7D 7E 01 02 01 00 09 40 09
						BE 19 FC 19 FA 19 F8 1A 38 1A
						78 1A B6 2A F6 2B 34 2B 74 3B
						74 6B F4 00 00 00 00 00 00 00
						00 00 00 00 00 00 00 00 00 00
						00 00 00 00 00 00 00 00 00 00
						00 00 00 00 00 00 00 00 00 00
						00 00 00
					39 01 00 00 00 00 04 FF 78 07 0E
					15 01 00 00 00 00 02 21 2D
					15 01 00 00 00 00 02 23 2D
					15 01 00 00 00 00 02 41 17
					15 01 00 00 00 00 02 43 17
					39 01 00 00 00 00 04 FF 78 07 02
					15 01 00 00 00 00 02 1B 01	// FR_sel:FPS/TP [00:120/180 01:144/144 02:60/180]
					39 01 00 00 00 00 04 FF 78 07 04
					15 01 00 00 00 00 02 BD 01	// GRAM Arbiter reset

					39 01 00 00 00 00 04 FF 78 07 01
					15 01 00 00 00 00 02 B3 08

					39 01 00 00 00 00 04 FF 78 07 00
					05 01 00 00 0A 00 01 29
                                        39 01 00 00 00 00 04 FF 78 07 0F
					];

				qcom,mdss-dsi-off-command = [
					39 01 00 00 00 00 04 FF 78 07 00
					05 01 00 00 14 00 01 28
					05 01 00 00 78 00 01 10];
				qcom,mdss-dsi-post-panel-on-command =[
					39 01 00 00 00 00 04 FF 78 07 00
				];
				qcom,mdss-dsi-cabc-off-command = [
					39 01 00 00 00 00 04 FF 78 07 00
					15 01 00 00 00 00 02 53 2C
					15 01 00 00 00 00 02 55 00
					39 01 00 00 00 00 04 FF 78 07 0F];
				qcom,mdss-dsi-cabc-ui-command = [
					39 01 00 00 00 00 04 FF 78 07 00
					15 01 00 00 00 00 02 53 2C
					15 01 00 00 00 00 02 55 01
					39 01 00 00 00 00 04 FF 78 07 0F];
				qcom,mdss-dsi-cabc-still-image-command = [
					39 01 00 00 00 00 04 FF 78 07 00
					15 01 00 00 00 00 02 53 2C
					15 01 00 00 00 00 02 55 02
					39 01 00 00 00 00 04 FF 78 07 0F];
				qcom,mdss-dsi-cabc-video-command = [
					39 01 00 00 00 00 04 FF 78 07 00
					15 01 00 00 00 00 02 53 2C
					15 01 00 00 00 00 02 55 03
					39 01 00 00 00 00 04 FF 78 07 0F];

				qcom,mdss-dsi-on-command-state = "dsi_lp_mode";
				qcom,mdss-dsi-off-command-state = "dsi_lp_mode";
				qcom,mdss-dsi-post-panel-on-command-state="dsi_lp_mode";
				qcom,mdss-dsi-cabc-off-command-state = "dsi_lp_mode";
				qcom,mdss-dsi-cabc-ui-command-state = "dsi_lp_mode";
				qcom,mdss-dsi-cabc-still-image-command-state = "dsi_lp_mode";
				qcom,mdss-dsi-cabc-video-command-state = "dsi_lp_mode";

				qcom,compression-mode = "dsc";
				qcom,mdss-dsc-slice-height = <12>;
				qcom,mdss-dsc-slice-width = <540>;
				qcom,mdss-dsc-slice-per-pkt = <2>;
				qcom,mdss-dsc-bit-per-component = <8>;
				qcom,mdss-dsc-bit-per-pixel = <8>;
				qcom,mdss-dsc-block-prediction-enable;
			};
		};
	};
};

&dsi_oplus21643_ds_ili7807s_1080_2412_120fps_vid {
	oplus,mdss-dsi-manufacture = "DS";
	oplus,mdss-dsi-vendor-name = "JDI_ILI7807S";
	oplus,mdss-dsi-pre-bl-delay-enabled;
	oplus,mdss-dsi-pre-bl-delay-ms = <30>;
	oplus,mdss-dsi-cabc-enabled;
	oplus,mdss-dsi-lp-config-flag;

	qcom,panel-supply-entries = <&dsi_panel_pwr_supply_labibb>;
	qcom,mdss-dsi-bl-pmic-control-type = "bl_ctrl_wled";
	qcom,mdss-dsi-bl-min-level = <1>;
	qcom,mdss-dsi-bl-max-level = <4095>;
	qcom,mdss-brightness-max-level = <4095>;
	qcom,mdss-dsi-bl-normal-max-level = <3276>;
	qcom,mdss-brightness-normal-max-level = <3276>;
	qcom,mdss-brightness-default-level = <891>;
	qcom,platform-te-gpio = <&tlmm 80 0>;
	qcom,platform-reset-gpio = <&tlmm 44 0>;
	qcom,dsi-select-clocks = "mux_byte_clk0", "mux_pixel_clk0",
		"src_byte_clk0", "src_pixel_clk0",
		"shadow_byte_clk0", "shadow_pixel_clk0";

	qcom,esd-check-enabled;
	qcom,mdss-dsi-panel-status-check-mode = "reg_read";
	qcom,mdss-dsi-panel-status-command = [06 01 00 01 00 00 01 09];
	qcom,mdss-dsi-panel-status-command-state = "dsi_lp_mode";
	qcom,mdss-dsi-panel-status-value = <0x80 0x03 0x06>;
	qcom,mdss-dsi-panel-status-read-length = <3>;

	qcom,mdss-dsi-pan-enable-dynamic-fps;
	qcom,mdss-dsi-pan-fps-update = "dfps_immediate_porch_mode_vfp";
	qcom,dsi-supported-dfps-list = <144 120 90 60 50 48 30>;
	qcom,mdss-dsi-qsync-min-refresh-rate = <30>;

	//qcom,dsi-dyn-clk-enable;
	//qcom,dsi-dyn-clk-type = "constant-fps-adjust-vfp";
	//qcom,dsi-dyn-clk-list = <901327680 893816616 897572152>;

	oplus,dsi-brightness-remapping = <4    4>,
	    <246   11>,
            <688   106>,
            <920   200>,
            <1096  295>,
            <1244  398>,
            <1373  484>,
            <1489  578>,
            <1596  673>,
            <1694  767>,
            <1786  862>,
            <1872  956>,
            <1954  1051>,
            <2032  1145>,
            <2107  1240>,
            <2178  1334>,
            <2247  1429>,
            <2313  1523>,
            <2377  1618>,
            <2440  1712>,
            <2500  1807>,
            <2559  1901>,
            <2616  1996>,
            <2671  2090>,
            <2725  2185>,
            <2778  2279>,
            <2830  2374>,
            <2881  2468>,
            <2930  2563>,
            <2979  2657>,
            <3027  2752>,
            <3074  2846>,
            <3119  2941>,
            <3165  3035>,
            <3209  3130>,
            <3253  3224>,
            <3276  3276>,
            <4095  4095>;

	qcom,mdss-dsi-t-clk-post = <0x0F>;
	qcom,mdss-dsi-t-clk-pre = <0x1E>;
	qcom,mdss-dsi-display-timings {
		timing@0 {
			qcom,mdss-dsi-panel-clockrate = <1107000000>;
			qcom,mdss-dsi-panel-phy-timings = [00 24 0A 0A 1A 18 0A
				0A 09 02 04 00 1E 0F];
			qcom,display-topology = <1 1 1>;
			qcom,default-topology-index = <0>;
		};
	};
};

&dsi_oplus21643_ds_ili7807s_1080_2412_120fps_vid {
	qcom,panel_voltage_vddi_name = "vddio";
	qcom,panel_voltage_vddi = <0 1650000 1800000 1950000>;
	qcom,panel_voltage_vddr_name = "vddio";
	qcom,panel_voltage_vddr = <1 1650000 1800000 1950000>;
};

