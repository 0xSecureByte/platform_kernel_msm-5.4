/dts-v1/;
/plugin/;

#include "yupik-overlay.dtsi"
#include "yupik-21603-overlay.dtsi"
#include "yupik-camera-sensor-21603.dtsi"
#include "yupik-21603-audio-overlay.dtsi"
/ {
	model = "Qualcomm Technologies, Inc. Yupik IDP";
	compatible = "qcom,yupik-idp", "qcom,yupik", "qcom,idp";
	qcom,board-id = <34 0>;
	oplus,dtsi_no = <21603>;
};
