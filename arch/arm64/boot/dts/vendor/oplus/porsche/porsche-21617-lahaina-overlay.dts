#include "../../qcom/lahaina-mtp-overlay.dts"
//#include "lahaina_overlay_oplus_common.dtsi"
//#include "lahaina_overlay_oplus_common_pinctrl.dtsi"
#include "lahaina-camera-sensor-21617.dtsi"
#include "porsche-common.dtsi"
#include "porsche-21617.dtsi"
#include "nfc/porsche-nfc-sn100t.dtsi"

/ {
	model = "Qualcomm Technologies, Inc. Lahaina MTP";
	compatible = "qcom,lahaina-mtp", "qcom,lahaina", "qcom,mtp";
	qcom,board-id = <0x10008 0>;
	oplus,dtsi_no = <21617>;
};
