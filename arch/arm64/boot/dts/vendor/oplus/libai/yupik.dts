/dts-v1/;

#include "../../qcom/yupik.dtsi"
#include "../../qcom/yupik-idp-pm7250b.dtsi"

/ {
	model = "Qualcomm Technologies, Inc. Yupik IDP";
	compatible = "qcom,yupik-idp", "qcom,yupik", "qcom,idp";
	qcom,board-id = <34 0>;
	oplus,dtsi_no = <21031>;
	aliases {
                ufshc1 = &ufshc_mem; /* Embedded UFS Slot */
                sdhc0 = &sdhc_1; /*SDC1 eMMC slot*/
                sdhc1 = &sdhc_2; /* SDC2 SD card slot */
                serial0 = &qupv3_se5_2uart;
                hsuart0 = &qupv3_se7_4uart;
                swr0 = &swr0;
                swr1 = &swr1;
                swr2 = &swr2;
                i2c0 = &qupv3_se1_i2c;
        };
};
