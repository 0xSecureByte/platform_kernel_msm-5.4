/dts-v1/;
/plugin/;

#include "yupik-overlay.dtsi"
#include "yupik-21031-overlay.dtsi"
#include "yupik-camera-sensor-21031.dtsi"
#include "yupik-21031-audio-overlay.dtsi"
//#ifdef OPLUS_FEATURE_NFC_BRINGUP
#include "nfc/libai-nfc-sn100t.dtsi"
//#endif OPLUS_FEATURE_NFC_BRINGUP
/ {
	model = "Qualcomm Technologies, Inc. Yupik IDP";
	compatible = "qcom,yupik-idp", "qcom,yupik", "qcom,idp";
	qcom,board-id = <34 0>;
	oplus,dtsi_no = <21031>;
	oplus,pcb_range = <0 39>;
};
