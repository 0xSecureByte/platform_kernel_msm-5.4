/dts-v1/;
/plugin/;

#include "yupik-overlay.dtsi"
#include "yupik-21643-overlay.dtsi"
#include "yupik-21643-audio-overlay.dtsi"
#include "sensor/ice-sensor-21643.dtsi"
#include "yupik-camera-sensor-21643.dtsi"
/ {
	model = "Qualcomm Technologies, Inc. Yupik IDP";
	compatible = "qcom,yupik-idp", "qcom,yupik", "qcom,idp";
	qcom,board-id = <34 0>;
	oplus,dtsi_no = <21643>;
};
