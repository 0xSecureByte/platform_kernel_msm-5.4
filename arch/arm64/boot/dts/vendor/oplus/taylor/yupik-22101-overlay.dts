/dts-v1/;
/plugin/;

#include "yupik-overlay.dtsi"
#include "yupik-22101-overlay.dtsi"
#include "yupik-22101-audio-overlay.dtsi"
//#include "regulator/wl2868c.dtsi"
#include "yupik-camera-sensor-22101.dtsi"
//#ifdef OPLUS_FEATURE_NFC_BRINGUP
#include "nfc/taylor-nfc-sn100t.dtsi"
#include "taylor-common.dtsi"
//#endif OPLUS_FEATURE_NFC_BRINGUP
/ {
	model = "Qualcomm Technologies, Inc. Yupik IDP";
	compatible = "qcom,yupik-idp", "qcom,yupik", "qcom,idp";
	qcom,board-id = <34 0>;
	oplus,dtsi_no = <22101>;
	oplus,pcb_range = <0 1450>;
};
