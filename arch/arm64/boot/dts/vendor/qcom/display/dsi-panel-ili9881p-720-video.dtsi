&mdss_mdp {
	dsi_ili9881p_720p_video: qcom,mdss_dsi_ili9881c_720p_video {
		qcom,mdss-dsi-panel-name = "ILI9881P 720p video signal panel";
		qcom,mdss-dsi-panel-type = "dsi_video_mode";

		qcom,dsi-ctrl-num = <0>;
		qcom,dsi-phy-num = <0>;

		qcom,mdss-dsi-virtual-channel-id = <0>;
		qcom,mdss-dsi-stream = <0>;
		qcom,mdss-dsi-h-left-border = <0>;
		qcom,mdss-dsi-h-right-border = <0>;
		qcom,mdss-dsi-v-top-border = <0>;
		qcom,mdss-dsi-v-bottom-border = <0>;
		qcom,mdss-dsi-bpp = <24>;
		qcom,mdss-dsi-underflow-color = <0x3ff>;
		qcom,mdss-dsi-border-color = <0>;
		qcom,mdss-dsi-h-sync-pulse = <0>;
		qcom,mdss-dsi-traffic-mode = "burst_mode";
		qcom,mdss-dsi-bllp-eof-power-mode;
		qcom,mdss-dsi-bllp-power-mode;
		qcom,mdss-dsi-lane-0-state;
		qcom,mdss-dsi-lane-1-state;
		qcom,mdss-dsi-lane-2-state;
		qcom,mdss-dsi-lane-3-state;
		qcom,mdss-dsi-lp11-init;
		qcom,mdss-dsi-dma-trigger = "trigger_sw";
		qcom,mdss-dsi-mdp-trigger = "none";
		qcom,mdss-pan-physical-width-dimension = <62>;
		qcom,mdss-pan-physical-height-dimension = <110>;
		qcom,mdss-dsi-reset-sequence = <1 20>, <0 1>, <1 20>;

		qcom,mdss-dsi-display-timings {
			timing@0 {
				qcom,mdss-dsi-panel-width = <720>;
				qcom,mdss-dsi-panel-height = <1440>;
				qcom,mdss-dsi-h-front-porch = <200>;
				qcom,mdss-dsi-h-back-porch = <100>;
				qcom,mdss-dsi-h-pulse-width = <8>;
				qcom,mdss-dsi-h-sync-skew = <0>;
				qcom,mdss-dsi-v-back-porch = <24>;
				qcom,mdss-dsi-v-front-porch = <24>;
				qcom,mdss-dsi-v-pulse-width = <8>;
				qcom,mdss-dsi-panel-framerate = <60>;
				qcom,mdss-dsi-on-command = [
					39 01 00 00 00 00 04 FF 98 81 05
					39 01 00 00 00 00 02 B2 70
					39 01 00 00 00 00 02 03 00
					39 01 00 00 00 00 02 04 2c
					39 01 00 00 00 00 02 4C 11
					39 01 00 00 00 00 02 1A 50
					39 01 00 00 00 00 02 38 A0
					39 01 00 00 00 00 02 4D 22
					39 01 00 00 00 00 02 54 28
					39 01 00 00 00 00 02 55 25
					39 01 00 00 00 00 02 1B 09
					39 01 00 00 00 00 02 26 0E
					39 01 00 00 00 00 02 78 01
					39 01 00 00 00 00 02 A9 C0
					39 01 00 00 00 00 02 B1 70
					39 01 00 00 00 00 02 1E 11
					39 01 00 00 00 00 04 FF 98 81 02
					39 01 00 00 00 00 02 01 50
					39 01 00 00 00 00 02 15 10
					39 01 00 00 00 00 02 42 01
					39 01 00 00 00 00 02 44 01
					39 01 00 00 00 00 15 57 00 1B 2B 13 16 29 1E 1F 90 1E 2B 79 18 12 41 1E 26 4E 5D 2C
					39 01 00 00 00 00 15 6B 00 1B 2B 13 16 29 1E 1F 90 1E 2B 79 18 12 41 1E 26 4E 5D 2C
					39 01 00 00 00 00 04 FF 98 81 01
					39 01 00 00 00 00 02 01 00
					39 01 00 00 00 00 02 02 00
					39 01 00 00 00 00 02 03 56
					39 01 00 00 00 00 02 04 13
					39 01 00 00 00 00 02 05 13
					39 01 00 00 00 00 02 06 0a
					39 01 00 00 00 00 02 07 05
					39 01 00 00 00 00 02 08 05
					39 01 00 00 00 00 02 09 1D
					39 01 00 00 00 00 02 0a 01
					39 01 00 00 00 00 02 0b 00
					39 01 00 00 00 00 02 0c 3F
					39 01 00 00 00 00 02 0d 29
					39 01 00 00 00 00 02 0e 29
					39 01 00 00 00 00 02 0f 1D
					39 01 00 00 00 00 02 10 1D
					39 01 00 00 00 00 02 11 00
					39 01 00 00 00 00 02 12 00
					39 01 00 00 00 00 02 13 08
					39 01 00 00 00 00 02 14 08
					39 01 00 00 00 00 02 15 00
					39 01 00 00 00 00 02 16 00
					39 01 00 00 00 00 02 17 00
					39 01 00 00 00 00 02 18 00
					39 01 00 00 00 00 02 19 00
					39 01 00 00 00 00 02 1a 00
					39 01 00 00 00 00 02 1b 00
					39 01 00 00 00 00 02 1c 00
					39 01 00 00 00 00 02 1d 00
					39 01 00 00 00 00 02 1e 40
					39 01 00 00 00 00 02 1f 88
					39 01 00 00 00 00 02 20 08
					39 01 00 00 00 00 02 21 01
					39 01 00 00 00 00 02 22 00
					39 01 00 00 00 00 02 23 00
					39 01 00 00 00 00 02 24 00
					39 01 00 00 00 00 02 25 00
					39 01 00 00 00 00 02 26 00
					39 01 00 00 00 00 02 27 00
					39 01 00 00 00 00 02 28 33
					39 01 00 00 00 00 02 29 03
					39 01 00 00 00 00 02 2a 00
					39 01 00 00 00 00 02 2b 00
					39 01 00 00 00 00 02 2c 00
					39 01 00 00 00 00 02 2d 00
					39 01 00 00 00 00 02 2e 00
					39 01 00 00 00 00 02 2f 00
					39 01 00 00 00 00 02 30 00
					39 01 00 00 00 00 02 31 00
					39 01 00 00 00 00 02 32 00
					39 01 00 00 00 00 02 33 00
					39 01 00 00 00 00 02 34 00
					39 01 00 00 00 00 02 35 00
					39 01 00 00 00 00 02 36 00
					39 01 00 00 00 00 02 37 00
					39 01 00 00 00 00 02 38 00
					39 01 00 00 00 00 02 39 0f
					39 01 00 00 00 00 02 3a 2a
					39 01 00 00 00 00 02 3b 00
					39 01 00 00 00 00 02 3c 00
					39 01 00 00 00 00 02 3d 00
					39 01 00 00 00 00 02 3e 00
					39 01 00 00 00 00 02 3f 00
					39 01 00 00 00 00 02 40 00
					39 01 00 00 00 00 02 41 e0
					39 01 00 00 00 00 02 42 40
					39 01 00 00 00 00 02 43 0f
					39 01 00 00 00 00 02 44 11
					39 01 00 00 00 00 02 45 a8
					39 01 00 00 00 00 02 46 00
					39 01 00 00 00 00 02 47 08
					39 01 00 00 00 00 02 48 00
					39 01 00 00 00 00 02 49 01
					39 01 00 00 00 00 02 4a 00
					39 01 00 00 00 00 02 4b 00
					39 01 00 00 00 00 02 4c b2
					39 01 00 00 00 00 02 4d 22
					39 01 00 00 00 00 02 4e 01
					39 01 00 00 00 00 02 4f f7
					39 01 00 00 00 00 02 50 29
					39 01 00 00 00 00 02 51 72
					39 01 00 00 00 00 02 52 25
					39 01 00 00 00 00 02 53 b2
					39 01 00 00 00 00 02 54 22
					39 01 00 00 00 00 02 55 22
					39 01 00 00 00 00 02 56 22
					39 01 00 00 00 00 02 57 a2
					39 01 00 00 00 00 02 58 22
					39 01 00 00 00 00 02 59 01
					39 01 00 00 00 00 02 5a e6
					39 01 00 00 00 00 02 5b 28
					39 01 00 00 00 00 02 5c 62
					39 01 00 00 00 00 02 5d 24
					39 01 00 00 00 00 02 5e a2
					39 01 00 00 00 00 02 5f 22
					39 01 00 00 00 00 02 60 22
					39 01 00 00 00 00 02 61 22
					39 01 00 00 00 00 02 62 ee
					39 01 00 00 00 00 02 63 02
					39 01 00 00 00 00 02 64 0b
					39 01 00 00 00 00 02 65 02
					39 01 00 00 00 00 02 66 02
					39 01 00 00 00 00 02 67 01
					39 01 00 00 00 00 02 68 00
					39 01 00 00 00 00 02 69 0f
					39 01 00 00 00 00 02 6a 07
					39 01 00 00 00 00 02 6b 55
					39 01 00 00 00 00 02 6c 02
					39 01 00 00 00 00 02 6d 02
					39 01 00 00 00 00 02 6e 5b
					39 01 00 00 00 00 02 6f 59
					39 01 00 00 00 00 02 70 02
					39 01 00 00 00 00 02 71 02
					39 01 00 00 00 00 02 72 57
					39 01 00 00 00 00 02 73 02
					39 01 00 00 00 00 02 74 02
					39 01 00 00 00 00 02 75 02
					39 01 00 00 00 00 02 76 02
					39 01 00 00 00 00 02 77 02
					39 01 00 00 00 00 02 78 02
					39 01 00 00 00 00 02 79 02
					39 01 00 00 00 00 02 7a 0a
					39 01 00 00 00 00 02 7b 02
					39 01 00 00 00 00 02 7c 02
					39 01 00 00 00 00 02 7d 01
					39 01 00 00 00 00 02 7e 00
					39 01 00 00 00 00 02 7f 0e
					39 01 00 00 00 00 02 80 06
					39 01 00 00 00 00 02 81 54
					39 01 00 00 00 00 02 82 02
					39 01 00 00 00 00 02 83 02
					39 01 00 00 00 00 02 84 5a
					39 01 00 00 00 00 02 85 58
					39 01 00 00 00 00 02 86 02
					39 01 00 00 00 00 02 87 02
					39 01 00 00 00 00 02 88 56
					39 01 00 00 00 00 02 89 02
					39 01 00 00 00 00 02 8a 02
					39 01 00 00 00 00 02 8b 02
					39 01 00 00 00 00 02 8c 02
					39 01 00 00 00 00 02 8d 02
					39 01 00 00 00 00 02 8e 02
					39 01 00 00 00 00 02 8f 44
					39 01 00 00 00 00 02 90 44
					39 01 00 00 00 00 04 FF 98 81 06
					39 01 00 00 00 00 02 01 03
					39 01 00 00 00 00 02 2B 0A
					39 01 00 00 00 00 02 04 70
					39 01 00 00 00 00 02 C0 CF
					39 01 00 00 00 00 02 C1 2A
					39 01 00 00 00 00 04 FF 98 81 00
					05 01 00 00 FF 00 01 11
					05 01 00 00 28 00 01 29
					39 01 00 00 00 00 02 35 00
					39 01 00 00 00 00 02 36 00
				];
				qcom,mdss-dsi-off-command = [
					05 01 00 00 14 00 01 28
					05 01 00 00 78 00 01 10
				];
				qcom,mdss-dsi-on-command-state = "dsi_lp_mode";
				qcom,mdss-dsi-off-command-state = "dsi_hs_mode";
			};
		};
	};
};

