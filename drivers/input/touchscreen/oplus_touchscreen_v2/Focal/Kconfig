## drivers/input/touchscreen/oplus_touchscreen_v2/Focal/Kconfig
```kconfig
source "drivers/input/touchscreen/oplus_touchscreen_v2/Focal/ft3518/Kconfig"
source "drivers/input/touchscreen/oplus_touchscreen_v2/Focal/ft3658u/Kconfig"
```

## drivers/input/touchscreen/oplus_touchscreen_v2/Focal/ft3518/Kconfig
```kconfig
config TOUCHPANEL_FOCAL_FT3518
	tristate "TP focal ft3518 IC enable or not for OPLUS"
	help
	Say Y to enable driver for Touchpanel using Focal FT3518
	Say M to enable driver for Touchpanel using Focal FT3518 as module
```

## drivers/input/touchscreen/oplus_touchscreen_v2/Focal/ft3658u/Kconfig
```kconfig
config TOUCHPANEL_FOCAL_FT3658U
	tristate "TP focal ft3658u IC enable or not for OPLUS"
	help
	say Y to enable driver for Touchpanel using Focal FT3658U
```

## drivers/input/touchscreen/oplus_touchscreen_v2/Goodix/GT9886/Kconfig
```kconfig
config TOUCHPANEL_GOODIX_GT9886
#   default y
    tristate "TP goodix gt9886 IC enable or not for OPLUS"
    help
    Say Y to enable driver for Touchpanel useing goodix gt9886
    Say M to enable driver for Touchpanel useing goodix gt9886 as module

#endif
```

## drivers/input/touchscreen/oplus_touchscreen_v2/Himax/Kconfig
```kconfig
#source "drivers/input/touchscreen/oplus_touchscreen_v2/Himax/hx83112b/Kconfig"
source "drivers/input/touchscreen/oplus_touchscreen_v2/Himax/hx83112a_noflash/Kconfig"
#source "drivers/input/touchscreen/oplus_touchscreen_v2/Himax/hx83112b_noflash/Kconfig"
```

## drivers/input/touchscreen/oplus_touchscreen_v2/Himax/hx83112a_noflash/Kconfig
```kconfig
#ifdef OPLUS_FEATURE_TP_BASIC

config TOUCHPANEL_HIMAX_HX83112A_NOFLASH
#	default y
	tristate "TP himax hx83112a no-flash IC enable or not for OPLUS"
	help
	Say Y to enable driver for Touchpanel useing himax hx83112a no-flash
	Say M to enable driver for Touchpanel useing himax hx83112a no-flash as module

#endif
```

## drivers/input/touchscreen/oplus_touchscreen_v2/Kconfig
```kconfig
config TOUCHPANEL_MTK_PLATFORM
    bool "OPLUS platform tp module used"
    help
      Say Y here if you have mtk-platform.

config TOUCHPANEL_LATE_INIT
    bool "mk6360 pmic init"
    help
      Say Y here if you have mk6360 pmic.

config TOUCHIRQ_UPDATE_QOS
    bool "OPLUS touchpanel driver update qos"
    help
      Say Y here if you want to update qos value in irq handler.

config TOUCHPANEL_NEW_SET_IRQ_WAKE
    bool "OPLUS platform tp module used"
    help
      Say Y here if call enable_irq_wake, can not call disable_irq_nosync

config TOUCHPANEL_OPLUS
    tristate "OPLUS tp module"
    help
      Say Y here if you have touchscreen build into driver.
      Say M here if you have touchscreen as module.

config OPLUS_MTK_DRM_GKI_NOTIFY
       default n
       tristate "tp mtk gki notify"

config OPLUS_TP_APK
    bool "OPLUS apk node create"
    help
      Say Y here if you use apk for TP.


config REMOVE_OPLUS_FUNCTION
    bool "REMOVE_OPLUS_FUNCTION"
    help
      Say Y here if you want to remove all oplus function when bring up.

config TOUCHPANEL_MULTI_NOFLASH
    bool "Multiple noflash TPs using"
    help
      Say Y here if you have multiple noflash touchscreen.

config TOUCHPANEL_NOTIFY
    tristate "touch notify"
    help
      Say Y here if you have touchscreen notify build into driver.
      Say M here if you have touchscreen notify as module.

config TOUCHPANEL_SYNAPTICS
    tristate "TP Synaptics_IC enable or not for OPLUS"
    help
    Say Y to enable driver for Touchpanel using Synaptics_IC
    Say M to enable driver for Touchpanel using Synaptics_IC as module.

config TOUCHPANEL_FOCAL
    tristate "TP Focal_IC enable or not for OPLUS"
    help
    Say Y to enable driver for Touchpanel using FOCALTECK_IC
    Say M to enable driver for Touchpanel using FOCALTECK_IC as module.

config TOUCHPANEL_GOODIX
    tristate "TP Goodix_IC enable or not for OPLUS"
    help
    Say Y to enable driver for Touchpanel using GOODIX_IC
    Say M to enable driver for Touchpanel using GOODIX_IC as module.

config TOUCHPANEL_NOVA
    tristate "TP Novatek_IC enable or not for OPLUS"
    help
    Say Y to enable driver for Touchpanel using NOVATECK_IC
    Say M to enable driver for Touchpanel using NOVATECK_IC as module.

config TOUCHPANEL_HIMAX
    tristate "TP HIMAX_IC enable or not for OPLUS"
    help
    Say Y to enable driver for Touchpanel using HIMAX_IC
    Say M to enable driver for Touchpanel using HIMAX_IC as module.

config TOUCHPANEL_SAMSUNG
    tristate "TP samsung IC enable or not for OPLUS"
    help
    Say Y to enable driver for Touchpanel using samsung IC
    Say M to enable driver for Touchpanel using samsung IC as module.

config TOUCHPANEL_ILITEK
    tristate "TP ilitek IC enable or not for OPLUS"
    help
    Say Y to enable driver for Touchpanel using ilitek IC
    Say M to enable driver for Touchpanel using ilitek IC as module.
config TOUCHPANEL_ST
	tristate "TP st IC enable or not for OPLUS"
	help
	Say Y to enable driver for Touchpanel using st IC
	Say M to enable driver for Touchpanel using st IC as module.

if TOUCHPANEL_SYNAPTICS
source "drivers/input/touchscreen/oplus_touchscreen_v2/Synaptics/Kconfig"
endif

if TOUCHPANEL_GOODIX
source "drivers/input/touchscreen/oplus_touchscreen_v2/Goodix/Kconfig"
endif

if TOUCHPANEL_FOCAL
source "drivers/input/touchscreen/oplus_touchscreen_v2/Focal/Kconfig"
endif

if TOUCHPANEL_NOVA
source "drivers/input/touchscreen/oplus_touchscreen_v2/Novatek/Kconfig"
endif

if TOUCHPANEL_HIMAX
source "drivers/input/touchscreen/oplus_touchscreen_v2/Himax/Kconfig"
endif
if TOUCHPANEL_SAMSUNG
source "drivers/input/touchscreen/oplus_touchscreen_v2/Samsung/Kconfig"
endif

if TOUCHPANEL_ILITEK
source "drivers/input/touchscreen/oplus_touchscreen_v2/ilitek/Kconfig"
endif
if TOUCHPANEL_ST
source "drivers/input/touchscreen/oplus_touchscreen_v2/St/Kconfig"
endif
```

## drivers/input/touchscreen/oplus_touchscreen_v2/Novatek/Kconfig
```kconfig
source "drivers/input/touchscreen/oplus_touchscreen_v2/Novatek/NT36672C_noflash/Kconfig"
```

## drivers/input/touchscreen/oplus_touchscreen_v2/Novatek/NT36672C_noflash/Kconfig
```kconfig
config TOUCHPANEL_NOVA_NT36672C_NOFLASH
#	default y
	tristate "TP nova nt36672C IC enable or not for OPLUS"
	help
	Say Y to enable driver for Touchpanel useing nova nt36672
	Say Y to enable driver for Touchpanel useing nova nt36672 as module
```

## drivers/input/touchscreen/oplus_touchscreen_v2/Samsung/S6SY791/Kconfig
```kconfig
#ifdef OPLUS_FEATURE_TP_BASIC


config TOUCHPANEL_SAMSUNG_S6SY791
#   default y
    tristate "TP Samsung s6sy791 IC enable or not for OPLUS"
    help
    Say Y to enable driver for Touchpanel using Samsung s6sy791
    Say M to enable driver for Touchpanel using Samsung s6sy791 as module

#endif
```

## drivers/input/touchscreen/oplus_touchscreen_v2/Samsung/S6SY792/Kconfig
```kconfig
config TOUCHPANEL_SAMSUNG_S6SY792
#   default y
    tristate "TP Samsung s6sy792 IC enable or not for OPLUS"
    help
    Say Y to enable driver for Touchpanel using Samsung s6sy792
    Say M to enable driver for Touchpanel using Samsung s6sy792 as module
```

## drivers/input/touchscreen/oplus_touchscreen_v2/Synaptics/Kconfig
```kconfig
source "drivers/input/touchscreen/oplus_touchscreen_v2/Synaptics/S3706/Kconfig"
source "drivers/input/touchscreen/oplus_touchscreen_v2/Synaptics/Syna_tcm_oncell/Kconfig"

config KUNIT_OPLUS_SYNAPTICS
    tristate "TP Synaptics-test enable or not"
    help
      Say Y here if you have a Synaptics test
      to your system.

      If unsure, say N.
```

## drivers/input/touchscreen/oplus_touchscreen_v2/Synaptics/S3706/Kconfig
```kconfig
#ifdef OPLUS_FEATURE_TP_BASIC

config TOUCHPANEL_SYNAPTICS_S3706
#    default y
    tristate "TP Synaptics_S3508 IC enable or not for OPLUS"
    help
    Say Y to enable driver for Touchpanel useing synaptics s3706
    Say M to enable driver for Touchpanel useing synaptics s3706

#endif
```

## drivers/input/touchscreen/oplus_touchscreen_v2/ilitek/Kconfig
```kconfig
source "drivers/input/touchscreen/oplus_touchscreen_v2/ilitek/ilitek9881h/Kconfig"
source "drivers/input/touchscreen/oplus_touchscreen_v2/ilitek/ilitek7807s/Kconfig"
```

## drivers/input/touchscreen/oplus_touchscreen_v2/ilitek/ilitek7807s/Kconfig
```kconfig
config TOUCHPANEL_ILITEK_ILITEK7807S
#	default y
	tristate "TP ilitek ilitek7807s IC enable or not for  OPLUS"
	help
	Say Y to enable driver for Touchpanel using ilitek ilitek7807s
	Say M to enable driver for Touchpanel using ilitek ilitek7807s as module
```

## drivers/input/touchscreen/oplus_touchscreen_v2/ilitek/ilitek9881h/Kconfig
```kconfig
#ifdef OPLUS_FEATURE_TP_BASIC

config TOUCHPANEL_ILITEK_ILITEK9881H_V3
#	default y
	tristate "TP ilitek ilitek9881h IC enable or not for OPLUS"
	help
	Say Y to enable driver for Touchpanel using ilitek ilitek9881h
	Say M to enable driver for Touchpanel using ilitek ilitek9881h as module

#endif
```

## drivers/soc/Kconfig
```kconfig
# SPDX-License-Identifier: GPL-2.0-only
menu "SOC (System On Chip) specific Drivers"

source "drivers/soc/actions/Kconfig"
source "drivers/soc/amlogic/Kconfig"
source "drivers/soc/aspeed/Kconfig"
source "drivers/soc/atmel/Kconfig"
source "drivers/soc/bcm/Kconfig"
source "drivers/soc/fsl/Kconfig"
source "drivers/soc/imx/Kconfig"
source "drivers/soc/ixp4xx/Kconfig"
source "drivers/soc/mediatek/Kconfig"
source "drivers/soc/qcom/Kconfig"
source "drivers/soc/renesas/Kconfig"
source "drivers/soc/rockchip/Kconfig"
source "drivers/soc/samsung/Kconfig"
source "drivers/soc/sunxi/Kconfig"
source "drivers/soc/tegra/Kconfig"
source "drivers/soc/ti/Kconfig"
source "drivers/soc/ux500/Kconfig"
source "drivers/soc/versatile/Kconfig"
source "drivers/soc/xilinx/Kconfig"
source "drivers/soc/zte/Kconfig"

#ifdef VENDOR_EDIT
source "drivers/soc/oplus/system/Kconfig"
#endif /* VENDOR_EDIT */

#ifdef OPLUS_FEATURE_TP_BASIC
source "drivers/soc/oplus/device_info/Kconfig"
#endif /* OPLUS_FEATURE_TP_BASIC */

#ifdef OPLUS_FEATURE_SENSOR_SMEM
source "drivers/soc/oplus/sensor/Kconfig"
#endif /* OPLUS_FEATURE_SENSOR_SMEM */

#ifdef OPLUS_FEATURE_SENSOR_CONSUMER_IR
source "drivers/soc/oplus/oplus_consumer_ir/Kconfig"
#endif /* OPLUS_FEATURE_SENSOR_CONSUMER_IR */

#ifdef OPLUS_FEATURE_ESIM
source "drivers/soc/oplus/misc/Kconfig"
#endif /* OPLUS_FEATURE_ESIM */
endmenu
```
